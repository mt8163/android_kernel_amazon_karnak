## drivers/misc/mediatek/sensors-1.0/barometer/Kconfig
```kconfig
config CUSTOM_KERNEL_BAROMETER
	bool "CUSTOM_KERNEL_BAROMETER"
	help
	  To detect barometer raw data

source "drivers/misc/mediatek/sensors-1.0/barometer/BMP180/Kconfig"
source "drivers/misc/mediatek/sensors-1.0/barometer/BMP180-new/Kconfig"
```

## drivers/misc/mediatek/sensors-1.0/gyroscope/bmi160_gyro/Kconfig
```kconfig
config MTK_BMI160_GYRO
	bool "Support Bosch BMI160 gyroscope for MediaTek package"
	help
	  It support different gyroscope sensor.
          If this option is set,
	  it will support
          BMI160 Gyroscope.
```

## drivers/misc/mediatek/sensors-1.0/sensorHub/Kconfig
```kconfig
config CUSTOM_KERNEL_SENSORHUB
	bool "CUSTOM_KERNEL_SENSORHUB"
	help
	  Kernel space sensor hub driver. Define project used all sensor hub
	  sensors. The value is combination of sensor hub driver(get data...etc)
	  and sensor hub framework driver(transmit shf info)

source "drivers/misc/mediatek/sensors-1.0/sensorHub/SCP_sensorHub/Kconfig"
source "drivers/misc/mediatek/sensors-1.0/sensorHub/SCP_shf/Kconfig"
```

## drivers/misc/mediatek/thermal/Kconfig
```kconfig
config MTK_THERMAL_PA_VIA_ATCMD
	bool "Thermal switch for query modem RF temp"
	help
	  Internal switch for thermal management
	  to query modem RF temperature
	  via AT command.
	  (RIL sockets)

config CLATM_CHOOSE_HIGHER_TARGET_TJ
	bool "adaptive cooler will choose the one who has higher target Tj"
	help
	  Change ATM decide TTj logic.
	  It will choose the adaptive cooler with higher Target Tj
	  and use the higher trip point as target Tj
	  when more than one adaptive active.
	default n

config VS_BACKLIGHT_COOLER
	bool "Virtual Sensor backlight cooler"
	default n

config THERMAL_abc123
	bool "THERMAL_abc123"
	default n
	help
	  For abc123 specific configurations for thermal related.

config THERMAL_abc123
	bool "THERMAL_abc123"
	default n
	help
	  For abc123 specific configurations for thermal related.

config VS_BCCT_COOLER
	bool "Virtual Sensor battery current cooler"
	default n

config THERMAL_abc123
	bool "THERMAL_abc123"
	default n
	help
	  For abc123 specific configurations for thermal related.

config THERMAL_KARNAK
	bool "THERMAL_KARNAK"
	default n
	help
	  For KARNAK specific configurations for thermal related.

source "drivers/misc/mediatek/thermal/tmp103/Kconfig"
```

## drivers/misc/mediatek/thermal/tmp103/Kconfig
```kconfig
config MTK_TMP103
	bool "TMP103 for MediaTek package"
	default n
	help
	  If this option is set, it will support
	  ambient and light sensor TMP103.
```

## drivers/misc/mediatek/usb11/Kconfig
```kconfig
config MTK_USBFSH
	bool "MTK_USBFSH"
	default n

config MTK_USB_RESET_WIFI_DONGLE
	bool "Mediatek USB host reset WIFI dongle suport"
	default n
	help
	  Say Y here if your system needs use reset USB WIFI dongle by USB host driver.
```

## drivers/misc/mediatek/usb20/Kconfig
```kconfig
config USB_MTK_HDRC
	tristate "MediaTek MUSB support"
	select USB_GADGET_SELECTED
	select USB_GADGET_DUALSPEED
	help
	  Say Y here if your system has a high speed USB
	  controller based on the MTK MUSB IP.  Then
	  configure options to match your silicon and the board
	  it's being used with, including the USB peripheral role,
	  or the USB host role, or both.

config USB_AMAZON_DOCK
	tristate "Amazon Dock Support"
	depends on USB_MTK_HDRC
	default n
	help
	  Say Y here if you want to support Amazon dock (Zeus),
	  which is a Amazon special Dock, it's different with
	  ACA Dock.

config MTK_MUSB_QMU_SUPPORT
	bool "QMU Transfer mode of MediaTek MUSB"
	depends on USB_MTK_HDRC
	help
	  Say Y here if your system has a QMU capability for USB
	  controller based on the MTK MUSB IP.
	  QMU is some kind of enhanced DMA mode by HW queeu rather
	  than SW queue to reduce SW effort.

config MTK_USB_CMD_CHANGE_MODE
       bool "MediaTek USB mode switch support"
       depends on USB_MTK_HDRC
       help
          switch USB mode by cmd, not only depend on ID pin.
          use 'echo xxxx > /proc/mchange' to switch usb host.
          such as 'echo host > /proc/mchange'
          Say Y here if your want to use software to switch usb mode.

config USB_MTK_OTG
	bool "MediaTek MUSB OTG support"
	help
	  Enable Mediatek USB Host OTG detection mechanism
	  and USB-IF Compliance Test Program.
	  1. IDDIG - OTG cable attachment detection.
	  2. DRVVBUS - provides the VBUS for the attached devices

config USB_MTK_CHARGER_DETECT
	bool "MediaTek MUSB charger detect"
	depends on MTK_USBFSH
	help
	  If make port1 enable in mt8163, please open the config.
	  When port0 is using, plug in device to port1,
	  port0 will get the disconnect. fix the issue, need open
	  the config.

config MTK_UART_USB_SWITCH
	bool "MediaTek UART could use USB DATA pins"
	help
	  This is a feature for debugging purpose.
	  It uses the USB TX/RX as UART TX/RX.
	  A USB to UART cable is needed to use this feature.
	  Using the UI in the EngineerMode to switch between USB and UART mode.
	  After switching to UART mode and connect to the PC with a USB to UART cable,
	  you can connect to a Virtual COM port on the PC and get the log output to the UART console.

config MTK_MUSB_CARPLAY_SUPPORT
	bool "MediaTek MUSB Carplay support"
	help
	  Say Y here if your want to use carplay.

config USB_MTK_OTG_SWITCH
	bool "MediaTek OTG Function Switch"
	depends on USB_MTK_OTG
	---help---
	  Enable Mediatek OTG function Switch mechanism.
	  The default OTG DUALROLE function is disabled.
	  User can switch to enable or disable by command.
	  Say Y here if your want to use mechanism.
	  If unsure, say N.

config IDDIG_CONTROL
	bool "Mediatek USB iddig control suport"
	default n
	help
	  Say Y here if you hope that id pin to low voltage when system suspend.
```

## drivers/staging/amazon/Kconfig
```kconfig
menu "Amazon"

config AMAZON
	bool "Amazon Drivers"
	default N
	---help---
	  Enable support for various drivers needed on the Amazon Fire OS platform

if AMAZON


config AMAZON_SIGN_OF_LIFE
	bool "Amazon Sign of Life"
	help
	enable the life cycle metrics to log device boot and shutdown information

config AMAZON_SIGN_OF_LIFE_MTK
	bool "Amazon Sign of Life MTK platform implementation"
	help
	enable the life cycle metrics to log device boot and shutdown information on MTK Platform

config AMAZON_SIGN_OF_LIFE
	bool "Amazon Sign of Life"
	help
	enable the life cycle metrics to log device boot and shutdown information

config AMAZON_SIGN_OF_LIFE_MTK
	bool "Amazon Sign of Life MTK platform implementation"
	help
	enable the life cycle metrics to log device boot and shutdown information on MTK Platform

config AMAZON_POWEROFF_LOG
	bool "Long press key power off log"
	default N
	help
	enable Long press key power off log


config AMAZON_METRICS_LOG
	bool "Amazon Metrics logger driver"
	select RING_BUFFER
	default n
	---help---
		Enable Amazon Metrics/Vitals logger driver

config AMAZON_METRICS_LOG_TEST
	tristate "Amazon Metrics logger driver test module"
	depends on AMAZON_METRICS_LOG
	default n
	---help---
		Enable Amazon Metrics/Vitals logger test module

config AMAZON_INTEGRITY_MODULE
	tristate "Amazon Integrity Module"
	depends on AMAZON_METRICS_LOG
	default n
	---help---
	  Say Y here if you want to enable Amazon Integrity Module

endif # if AMAZON

endmenu
```

## sound/soc/mediatek/Kconfig
```kconfig
config MT_SND_SOC_V1
	bool "MT_SND_SOC_V1"
    default n
    help
        If you say Y, enable MT_SND_SOC_V1_driver.
config MT_SND_SOC_V2
    bool "MT_SND_SOC_V2"
	default n
	help
        If you say Y, enable MT_SND_SOC_V2_driver.
config MT_SND_SOC_V3
    bool "MT_SND_SOC_V3"
	default n
	help
        If you say Y, enable MT_SND_SOC_V3_driver.
config MT_SND_SOC_6580
    bool "MT_SND_SOC_6580"
	default n
	help
        If you say Y, enable MT_SND_SOC_6580_driver.
config MT_SND_SOC_6755
    bool "MT_SND_SOC_6755"
	default n
	help
        If you say Y, enable MT_SND_SOC_6755_driver.
config MT_SND_SOC_8163
    bool "MT_SND_SOC_8163"
	default n
	help
        If you say Y, enable MT_SND_SOC_8163_driver.

config MT_SND_SOC_8163_AMZN
    bool "MT_SND_SOC_8163_AMZN"
    select SND_SOC_TLV320AIC3101
    select SND_SOC_8_MICS if !SND_I2S_MCLK
    select SND_SOC_TLV320AIC32X4
	default n
	help
        If you say Y, enable MT_SND_SOC_8163_AMZN driver.

config SND_I2S_MCLK
    bool "Enable I2S_MCLK for DAC3203 and AIC3101"

config SND_SOC_8_MICS
	bool "Enable 4 ADC support for AIC3101"

config AMP_AW8737S
	bool "Using amplifier AW8737S"

config MTK_SPEAKER
	bool "MTK_SPEAKER"
	default n
	help
	  If you say Y, enable MTK_SPEAKER_AMP
config MTK_NXP_TFA9890
    bool "MTK_NXP_TFA9890"
	default n
	help
        If you say Y, enable MTK_NXP_TFA9890 driver.

config SND_SOC_MT8173
    tristate

config SND_SOC_MT8173_MT6391_MACH
    tristate "ASoC Audio driver for MT8173 with MT6391 codec"
    depends on ARCH_MT8173
    select SND_SOC_MT8173
    select SND_SOC_MT6391
    help
        This adds audio driver for MT8173 platform with the MT6391 audio codec.

config VOICE_DSP_MICBIAS0
	bool "Voice DSP Uses PMIC MICBIAS0 Providing Power"

config MT_SND_SOC_2701
    tristate

config SND_SOC_MT2701_EVB
	bool "SND_SOC_MT2701_EVB"
	select MT_SND_SOC_2701
	help
	  Say Y if you want to use the MT2701 EVB
	  Audio interfaces for MT2701.

config MTK_ALIGN_24BIT_DATA_8BIT_0
	bool "MTK_ALIGN_24BIT_DATA_8BIT_0"
	default n
	help
	  Say Y if you want alignment to be 24 bits data then padded with 8 0 bits.

config SND_SOC_MT2701_RT5640
	bool "SND_SOC_MT2701_RT5640"
	select MT_SND_SOC_2701
	select SND_SOC_RT5640
	help
	  This adds ASoC driver for Mediatek MT2701 boards
	  with the RT5640 audio codec.
	  Select Y if you have such device.

config MTK_16BIT_IN_24BIT_OUT
	bool "MTK_16BITS_IN_24BIT_OUT"
	default n
	help
	  Say Y if you output to be 24 bits with 16 bits input

config SND_BT_SCO_I2S
	bool "SND_BT_SCO_I2S"
	default n
	help
	  Say Y if you enable BT SCO through I2S0/I2S3 4 pin interface

config MTK_AUDIO_USE_SHARED_SRAM
	bool "MTK_AUDIO_USE_SHARED_SRAM"
	default n
	help
	  Say Y if you want to split the sram for playback (18K) and capture (18K).
```
