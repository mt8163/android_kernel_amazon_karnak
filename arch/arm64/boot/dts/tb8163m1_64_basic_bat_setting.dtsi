/*************************
 * Customized Battery Setting dtsi file
*************************/
&bat_comm {
	/* cust_charging.h */
	/* Charging Current Setting */
	ac_charger_current = <200000>;	/* Unit: 0.01 mA */
	charging_host_charger_current = <50000>;	/* Unit: 0.01 mA */
};

&bat_meter{
	vbat_channel_number = <6>;
	isense_channel_number = <7>;

	swchr_power_path = <1>;

	/* cust_battery_meter.h */
	/* Qmax for 0mA */
	q_max_pos_50 = <2950>;
	q_max_pos_25 = <2950>;
	q_max_pos_10 = <2950>;
	q_max_pos_0 = <2950>;
	q_max_neg_10 = <2950>;
	/* Qmax for 400mA, said high current */
	q_max_pos_50_h_current = <2880>;
	q_max_pos_25_h_current = <2880>;
	q_max_pos_10_h_current = <2880>;
	q_max_pos_0_h_current = <2880>;
	q_max_neg_10_h_current = <2880>;

	change_tracking_point = <1>;
	/* SW OCV tracking setting */
	cust_tracking_point = <14>;
	cust_r_sense = <200>;

	cust_poweron_delta_capacity_tolrance = <80>;
	cust_poweron_low_capacity_tolrance = <5>;
	cust_poweron_max_vbat_tolrance = <70>;
	cust_poweron_delta_vbat_tolrance = <60>;

	/* Fixed battery temperature */
	fixed_tbat_25 = <1>;

	batt_temperature_table_num = <17>;
	batt_temperature_table = <
				(-20) 75022
				(-15) 57926
				(-10) 45168
				(-5) 35548
				0 28224
				5 22595
				10 18231
				15 14820
				20 12133
				25 10000
				30 8295
				35 6922
				40 5810
				45 4903
				50 4160
				55 3547
				60 3039>;

	battery_profile_t0_num = <54>;
	battery_profile_t0 = <0 4163
				2 4136
				4 4116
				6 4097
				8 4079
				10 4061
				12 4044
				14 4027
				16 4011
				18 3996
				20 3983
				22 3969
				24 3956
				26 3943
				29 3930
				31 3919
				33 3907
				35 3893
				37 3880
				39 3863
				41 3848
				43 3836
				45 3825
				47 3817
				49 3810
				51 3804
				53 3798
				55 3793
				57 3788
				59 3784
				61 3780
				63 3777
				65 3774
				67 3771
				69 3768
				71 3765
				73 3760
				75 3754
				77 3747
				79 3741
				81 3733
				83 3721
				85 3710
				88 3694
				90 3684
				92 3679
				94 3670
				96 3649
				98 3568
				100 3438
				100 3396
				100 3376
				100 3366
				100 3358>;

	battery_profile_t1_num = <54>;
	battery_profile_t1 = <0 4163
				2 4136
				4 4116
				6 4097
				8 4079
				10 4061
				12 4044
				14 4027
				16 4011
				18 3996
				20 3983
				22 3969
				24 3956
				26 3943
				29 3930
				31 3919
				33 3907
				35 3893
				37 3880
				39 3863
				41 3848
				43 3836
				45 3825
				47 3817
				49 3810
				51 3804
				53 3798
				55 3793
				57 3788
				59 3784
				61 3780
				63 3777
				65 3774
				67 3771
				69 3768
				71 3765
				73 3760
				75 3754
				77 3747
				79 3741
				81 3733
				83 3721
				85 3710
				88 3694
				90 3684
				92 3679
				94 3670
				96 3649
				98 3568
				100 3438
				100 3396
				100 3376
				100 3366
				100 3358>;

	battery_profile_t1_5_num = <54>;
	battery_profile_t1_5 = <0 4163
				2 4136
				4 4116
				6 4097
				8 4079
				10 4061
				12 4044
				14 4027
				16 4011
				18 3996
				20 3983
				22 3969
				24 3956
				26 3943
				29 3930
				31 3919
				33 3907
				35 3893
				37 3880
				39 3863
				41 3848
				43 3836
				45 3825
				47 3817
				49 3810
				51 3804
				53 3798
				55 3793
				57 3788
				59 3784
				61 3780
				63 3777
				65 3774
				67 3771
				69 3768
				71 3765
				73 3760
				75 3754
				77 3747
				79 3741
				81 3733
				83 3721
				85 3710
				88 3694
				90 3684
				92 3679
				94 3670
				96 3649
				98 3568
				100 3438
				100 3396
				100 3376
				100 3366
				100 3358>;

	battery_profile_t2_num = <54>;
	battery_profile_t2 = <0 4163
				2 4136
				4 4116
				6 4097
				8 4079
				10 4061
				12 4044
				14 4027
				16 4011
				18 3996
				20 3983
				22 3969
				24 3956
				26 3943
				29 3930
				31 3919
				33 3907
				35 3893
				37 3880
				39 3863
				41 3848
				43 3836
				45 3825
				47 3817
				49 3810
				51 3804
				53 3798
				55 3793
				57 3788
				59 3784
				61 3780
				63 3777
				65 3774
				67 3771
				69 3768
				71 3765
				73 3760
				75 3754
				77 3747
				79 3741
				81 3733
				83 3721
				85 3710
				88 3694
				90 3684
				92 3679
				94 3670
				96 3649
				98 3568
				100 3438
				100 3396
				100 3376
				100 3366
				100 3358>;

	battery_profile_t3_num = <54>;
	battery_profile_t3 = <0 4163
				2 4136
				4 4116
				6 4097
				8 4079
				10 4061
				12 4044
				14 4027
				16 4011
				18 3996
				20 3983
				22 3969
				24 3956
				26 3943
				29 3930
				31 3919
				33 3907
				35 3893
				37 3880
				39 3863
				41 3848
				43 3836
				45 3825
				47 3817
				49 3810
				51 3804
				53 3798
				55 3793
				57 3788
				59 3784
				61 3780
				63 3777
				65 3774
				67 3771
				69 3768
				71 3765
				73 3760
				75 3754
				77 3747
				79 3741
				81 3733
				83 3721
				85 3710
				88 3694
				90 3684
				92 3679
				94 3670
				96 3649
				98 3568
				100 3438
				100 3396
				100 3376
				100 3366
				100 3358>;

	r_profile_t0_num = <54>;
	r_profile_t0 = <200 4163
				200 4136
				203 4116
				205 4097
				207 4079
				212 4061
				212 4044
				212 4027
				215 4011
				218 3996
				223 3983
				225 3969
				227 3956
				228 3943
				228 3930
				233 3919
				232 3907
				232 3893
				227 3880
				217 3863
				208 3848
				202 3836
				198 3825
				198 3817
				197 3810
				200 3804
				200 3798
				202 3793
				203 3788
				205 3784
				207 3780
				208 3777
				208 3774
				210 3771
				212 3768
				212 3765
				210 3760
				208 3754
				207 3747
				210 3741
				210 3733
				208 3721
				212 3710
				208 3694
				208 3684
				220 3679
				237 3670
				268 3649
				287 3568
				398 3438
				328 3396
				297 3376
				277 3366
				265 3358>;

	r_profile_t1_num = <54>;
	r_profile_t1 = <200 4163
				200 4136
				203 4116
				205 4097
				207 4079
				212 4061
				212 4044
				212 4027
				215 4011
				218 3996
				223 3983
				225 3969
				227 3956
				228 3943
				228 3930
				233 3919
				232 3907
				232 3893
				227 3880
				217 3863
				208 3848
				202 3836
				198 3825
				198 3817
				197 3810
				200 3804
				200 3798
				202 3793
				203 3788
				205 3784
				207 3780
				208 3777
				208 3774
				210 3771
				212 3768
				212 3765
				210 3760
				208 3754
				207 3747
				210 3741
				210 3733
				208 3721
				212 3710
				208 3694
				208 3684
				220 3679
				237 3670
				268 3649
				287 3568
				398 3438
				328 3396
				297 3376
				277 3366
				265 3358>;

	r_profile_t1_5_num = <54>;
	r_profile_t1_5 = <200 4163
				200 4136
				203 4116
				205 4097
				207 4079
				212 4061
				212 4044
				212 4027
				215 4011
				218 3996
				223 3983
				225 3969
				227 3956
				228 3943
				228 3930
				233 3919
				232 3907
				232 3893
				227 3880
				217 3863
				208 3848
				202 3836
				198 3825
				198 3817
				197 3810
				200 3804
				200 3798
				202 3793
				203 3788
				205 3784
				207 3780
				208 3777
				208 3774
				210 3771
				212 3768
				212 3765
				210 3760
				208 3754
				207 3747
				210 3741
				210 3733
				208 3721
				212 3710
				208 3694
				208 3684
				220 3679
				237 3670
				268 3649
				287 3568
				398 3438
				328 3396
				297 3376
				277 3366
				265 3358>;

	r_profile_t2_num = <54>;
	r_profile_t2 = <200 4163
				200 4136
				203 4116
				205 4097
				207 4079
				212 4061
				212 4044
				212 4027
				215 4011
				218 3996
				223 3983
				225 3969
				227 3956
				228 3943
				228 3930
				233 3919
				232 3907
				232 3893
				227 3880
				217 3863
				208 3848
				202 3836
				198 3825
				198 3817
				197 3810
				200 3804
				200 3798
				202 3793
				203 3788
				205 3784
				207 3780
				208 3777
				208 3774
				210 3771
				212 3768
				212 3765
				210 3760
				208 3754
				207 3747
				210 3741
				210 3733
				208 3721
				212 3710
				208 3694
				208 3684
				220 3679
				237 3670
				268 3649
				287 3568
				398 3438
				328 3396
				297 3376
				277 3366
				265 3358>;

	r_profile_t3_num = <54>;
	r_profile_t3 = <200 4163
				200 4136
				203 4116
				205 4097
				207 4079
				212 4061
				212 4044
				212 4027
				215 4011
				218 3996
				223 3983
				225 3969
				227 3956
				228 3943
				228 3930
				233 3919
				232 3907
				232 3893
				227 3880
				217 3863
				208 3848
				202 3836
				198 3825
				198 3817
				197 3810
				200 3804
				200 3798
				202 3793
				203 3788
				205 3784
				207 3780
				208 3777
				208 3774
				210 3771
				212 3768
				212 3765
				210 3760
				208 3754
				207 3747
				210 3741
				210 3733
				208 3721
				212 3710
				208 3694
				208 3684
				220 3679
				237 3670
				268 3649
				287 3568
				398 3438
				328 3396
				297 3376
				277 3366
				265 3358>;
};
