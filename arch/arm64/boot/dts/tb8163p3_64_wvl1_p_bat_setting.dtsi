/*************************
 * Customized Battery Setting dtsi file
*************************/
&bat_comm {
	/* cust_charging.h */
	/* Charging Current Setting */
	usb_charger_current = <50000>;	/* Unit: 0.01 mA */
	ac_charger_current = <100000>;	/* Unit: 0.01 mA */
	non_std_ac_charger_current = <100000>;	/* Unit: 0.01 mA */
	charging_host_charger_current = <50000>;	/* Unit: 0.01 mA */
	apple_0_5a_charger_current = <50000>;	/* Unit: 0.01 mA */
	apple_1_0a_charger_current = <100000>;	/* Unit: 0.01 mA */
	apple_2_1a_charger_current = <210000>;	/* Unit: 0.01 mA */

	/* Battery Temperature Protection */
	max_charge_temperature = <60>;
	max_charge_temperature_minus_x_degree = <60>;

	/* charger error check */
	bat_low_temp_protect_enable = <0>;
	v_charger_enable = <0>;	/* 1:on , 0:off */
	v_charger_max = <6500>;	/* unit: mV */
	v_charger_min = <4400>;

	/*  Tracking TIME */
	onehundred_percent_tracking_time = <10>;	/* Unit: second */
	npercent_tracking_time = <20>;	/* Unit: second */
	sync_to_real_tracking_time = <60>;	/* Unit: second */
	v_0percent_tracking = <3400>;	/* Unit: mV */

	/* High battery support */
	high_battery_voltage_support = <1>;

	/* JEITA related setting */
	mtk_jeita_standard_support=<1>;
	cust_soc_jeita_sync_time=<30>;
	jeita_temp_below_neg_10_cv_voltage=<4350000>; /* Unit: uV */
	jeita_temp_neg_10_to_pos_0_cv_voltage=<4350000>; /* Unit: uV */
	jeita_temp_pos_0_to_pos_10_cv_voltage=<4350000>; /* Unit: uV */
	jeita_temp_pos_10_to_pos_45_cv_voltage=<4350000>; /* Unit: uV */
	jeita_temp_pos_45_to_pos_60_cv_voltage=<4100000>; /* Unit: uV */
	jeita_temp_above_pos_60_cv_voltage=<4100000>; /* Unit: uV */
};

&bat_meter{

	/* cust_pmic.h */
	vbat_channel_number = <6>;
	isense_channel_number = <7>;
	vbattemp_channel_number = <5>;
	vcharger_channel_number = <4>;
	swchr_power_path = <1>;
	external_swchr_support = <1>;

	/* cust_battery_meter.h */
	/* ADC resistor  */
	r_bat_sense = <4>;
	r_i_sense = <4>;
	r_charger_1 = <330>;
	r_charger_2 = <39>;
	temperature_t0 = <110>;
	temperature_t1 = <0>;
	temperature_t1_5 = <10>;
	temperature_t2 = <25>;
	temperature_t3 = <50>;
	temperature_t = <255>;	/* this should be fixed, never change the value */
	fg_meter_resistance = <0>;

	/* Qmax for 0mA */
	q_max_pos_50 = <4740>;
	q_max_pos_25 = <4740>;
	q_max_pos_10 = <4740>;
	q_max_pos_0 = <4620>;
	q_max_neg_10 = <4200>;
	/* Qmax for 400mA, said high current */
	q_max_pos_50_h_current = <4685>;
	q_max_pos_25_h_current = <4695>;
	q_max_pos_10_h_current = <4610>;
	q_max_pos_0_h_current = <4108>;
	q_max_neg_10_h_current = <2010>;

	/* Qmax_500cycle for 0mA */
	q_max_pos_50_500cycle = <4320>;
	q_max_pos_25_500cycle = <4320>;
	q_max_pos_10_500cycle = <3960>;
	q_max_pos_0_500cycle = <2880>;
	q_max_neg_10_500cycle = <2880>;
	/* Qmax_500cycle for 600mA, high current */
	q_max_pos_50_h_current_500cycle = <4265>;
	q_max_pos_25_h_current_500cycle = <4275>;
	q_max_pos_10_h_current_500cycle = <3830>;
	q_max_pos_0_h_current_500cycle = <2368>;
	q_max_neg_10_h_current_500cycle = <2010>;

	/* Discharge percentage, 1: D5, 0: D2 */
	oam_d5 = <0>;

	change_tracking_point = <1>;
	/* SW OCV tracking setting */
	cust_tracking_point = <14>;
	cust_r_sense = <200>;
	cust_hw_cc = <0>;
	aging_tuning_value = <100>;
	cust_r_fg_offset = <0>;
	ocv_board_compesate = <0>;
	r_fg_board_base = <1000>;
	r_fg_board_slope = <1000>;
	car_tune_value = <100>;

	/* HW Fuel gague  */
	current_detect_r_fg = <10>;	/* Unit: mA */
	minerroroffset = <1000>;
	fg_vbat_average_size = <18>;
	r_fg_value = <10>;	/* Unit: mOhm */

	cust_poweron_delta_capacity_tolrance = <45>;
	cust_poweron_low_capacity_tolrance = <5>;
	cust_poweron_max_vbat_tolrance = <70>;
	cust_poweron_delta_vbat_tolrance = <60>;
	cust_poweron_delta_hw_sw_ocv_capacity_tolrance = <10>;

	/* Fixed battery temperature */
	fixed_tbat_25 = <0>;
	/* Dynamic change wake up period of battery thread when suspend */
	vbat_normal_wakeup = <3600>;	/* Unit: mV */
	vbat_low_power_wakeup = <3500>;	/* Unit: mV */
	normal_wakeup_period = <5400>;	/* Unit: second */
	low_power_wakeup_period = <300>;	/* Unit: second */
	close_poweroff_wakeup_period = <30>;	/* Unit: second */

	rbat_pull_up_r = <61900>;
	rbat_pull_down_r = <107000>;
	rbat_pull_up_volt = <1800>;

	step_of_qmax = <60>; /* Unit: mAh */

	batt_temperature_table_num = <17>;
	batt_temperature_table = <
				(-20) 499900
				(-15) 371600
				(-10) 278700
				(-5) 210800
				0 160800
				5 123800
				10 96030
				15 75100
				20 59190
				25 47000
				30 37590
				35 30270
				40 24540
				45 20020
				50 16430
				55 13570
				60 11270>;

	battery_profile_t0_num = <71>;
	battery_profile_t0 = <0 4323
				1 4321
				3 4294
				4 4273
				6 4254
				7 4237
				9 4221
				10 4205
				11 4191
				13 4176
				14 4162
				16 4149
				17 4135
				19 4122
				20 4109
				21 4098
				23 4087
				24 4075
				26 4061
				27 4044
				29 4026
				30 4009
				31 3993
				33 3980
				34 3968
				36 3958
				37 3949
				39 3940
				40 3931
				41 3921
				43 3911
				44 3902
				46 3893
				47 3884
				49 3875
				50 3867
				51 3859
				53 3852
				54 3845
				56 3839
				57 3833
				59 3827
				60 3821
				61 3816
				63 3812
				64 3808
				66 3804
				67 3800
				69 3798
				70 3795
				71 3793
				73 3791
				74 3788
				76 3786
				77 3784
				79 3782
				80 3780
				81 3777
				83 3774
				84 3771
				86 3768
				87 3764
				89 3759
				90 3755
				91 3750
				93 3745
				94 3739
				96 3732
				97 3726
				99 3719
				100 3712>;

	battery_profile_t1_num = <78>;
	battery_profile_t1 = <0 4315
				1 4294
				3 4277
				4 4261
				5 4246
				6 4232
				8 4218
				9 4203
				10 4190
				12 4177
				13 4164
				14 4151
				16 4138
				17 4125
				18 4112
				19 4100
				21 4089
				22 4080
				23 4070
				25 4057
				26 4041
				27 4022
				29 4006
				30 3991
				31 3980
				32 3971
				34 3963
				35 3954
				36 3944
				38 3933
				39 3922
				40 3912
				42 3901
				43 3890
				44 3881
				45 3872
				47 3864
				48 3856
				49 3849
				51 3843
				52 3837
				53 3831
				55 3826
				56 3821
				57 3816
				58 3811
				60 3807
				61 3803
				62 3800
				64 3796
				65 3793
				66 3790
				68 3788
				69 3786
				70 3784
				71 3782
				73 3779
				74 3777
				75 3775
				77 3772
				78 3768
				79 3765
				81 3761
				82 3756
				83 3751
				84 3745
				86 3738
				87 3731
				88 3723
				90 3715
				91 3708
				92 3701
				94 3698
				95 3694
				96 3688
				97 3678
				99 3656
				100 3611>;

	battery_profile_t1_5_num = <80>;
	battery_profile_t1_5 = <0 4312
				1 4294
				3 4278
				4 4263
				5 4249
				6 4234
				8 4220
				9 4207
				10 4193
				11 4180
				13 4166
				14 4154
				15 4140
				16 4128
				18 4115
				19 4103
				20 4090
				22 4080
				23 4071
				24 4061
				25 4046
				27 4029
				28 4013
				29 3999
				30 3989
				32 3981
				33 3974
				34 3965
				35 3956
				37 3945
				38 3934
				39 3922
				41 3909
				42 3898
				43 3887
				44 3877
				46 3868
				47 3860
				48 3853
				49 3847
				51 3841
				52 3835
				53 3829
				54 3825
				56 3820
				57 3815
				59 3811
				59 3807
				61 3803
				62 3799
				63 3796
				65 3792
				66 3790
				67 3786
				68 3783
				70 3781
				71 3780
				72 3777
				73 3774
				75 3770
				76 3767
				77 3762
				78 3759
				80 3754
				81 3750
				82 3744
				84 3737
				85 3730
				86 3723
				87 3714
				89 3705
				90 3699
				91 3697
				92 3695
				94 3692
				95 3685
				96 3664
				97 3612
				99 3537
				100 3423>;

	battery_profile_t2_num = <80>;
	battery_profile_t2 = <0 4308
				1 4291
				3 4276
				4 4261
				5 4247
				6 4233
				8 4219
				9 4205
				10 4192
				11 4178
				13 4165
				14 4152
				15 4139
				16 4126
				18 4113
				19 4101
				20 4088
				22 4077
				23 4066
				24 4055
				25 4043
				27 4029
				28 4016
				29 4005
				30 3996
				32 3987
				33 3978
				34 3969
				35 3959
				37 3949
				38 3938
				39 3927
				41 3914
				42 3901
				43 3889
				44 3878
				46 3869
				47 3861
				48 3854
				49 3847
				51 3842
				52 3836
				53 3831
				54 3825
				56 3821
				57 3816
				58 3812
				59 3808
				61 3804
				62 3800
				63 3796
				65 3793
				66 3790
				67 3786
				68 3783
				70 3780
				71 3776
				72 3772
				73 3767
				75 3763
				76 3758
				77 3753
				78 3749
				80 3745
				81 3740
				82 3735
				84 3728
				85 3721
				86 3714
				87 3706
				89 3696
				90 3693
				91 3691
				92 3690
				94 3688
				95 3681
				96 3654
				97 3599
				99 3523
				100 3407>;

	battery_profile_t3_num = <80>;
	battery_profile_t3 = <0 4310
				1 4302
				3 4286
				4 4271
				5 4256
				6 4242
				8 4228
				9 4214
				10 4200
				11 4186
				13 4173
				14 4160
				15 4147
				16 4134
				18 4121
				19 4108
				20 4096
				22 4084
				23 4071
				24 4060
				25 4048
				27 4037
				28 4026
				29 4015
				30 4004
				32 3994
				33 3984
				34 3974
				35 3964
				37 3955
				38 3945
				39 3936
				41 3925
				42 3913
				43 3899
				44 3886
				46 3875
				47 3866
				48 3859
				49 3852
				51 3845
				52 3839
				53 3834
				54 3828
				56 3823
				57 3818
				58 3813
				59 3809
				61 3805
				62 3800
				63 3797
				65 3793
				66 3790
				67 3786
				68 3783
				70 3779
				71 3774
				72 3766
				73 3757
				75 3752
				76 3746
				77 3741
				78 3736
				80 3731
				81 3726
				82 3722
				84 3716
				85 3709
				86 3702
				87 3696
				89 3687
				90 3679
				91 3678
				92 3677
				94 3675
				95 3672
				96 3660
				97 3618
				99 3557
				100 3472>;

	r_profile_t0_num = <71>;
	r_profile_t0 = <1020 4323
				1020 4321
				1007 4294
				994 4273
				981 4254
				968 4237
				956 4221
				947 4205
				935 4191
				927 4176
				917 4162
				909 4149
				902 4135
				891 4122
				885 4109
				878 4098
				876 4087
				871 4075
				867 4061
				858 4044
				846 4026
				834 4009
				825 3993
				820 3980
				817 3968
				815 3958
				815 3949
				811 3940
				812 3931
				808 3921
				806 3911
				804 3902
				803 3893
				799 3884
				801 3875
				799 3867
				801 3859
				799 3852
				802 3845
				800 3839
				802 3833
				802 3827
				805 3821
				806 3816
				809 3812
				812 3808
				815 3804
				819 3800
				823 3798
				829 3795
				836 3793
				843 3791
				850 3788
				859 3786
				872 3784
				887 3782
				901 3780
				916 3777
				932 3774
				949 3771
				966 3768
				988 3764
				1005 3759
				1026 3755
				1050 3750
				1071 3745
				1089 3739
				1114 3732
				1135 3726
				1156 3719
				1179 3712>;

	r_profile_t1_num = <78>;
	r_profile_t1 = <393 4315
				393 4294
				397 4277
				395 4261
				397 4246
				393 4232
				392 4218
				388 4203
				390 4190
				388 4177
				387 4164
				387 4151
				385 4138
				385 4125
				383 4112
				382 4100
				382 4089
				387 4080
				390 4070
				388 4057
				385 4041
				375 4022
				370 4006
				367 3991
				367 3980
				367 3971
				367 3963
				365 3954
				363 3944
				358 3933
				353 3922
				352 3912
				348 3901
				345 3890
				345 3881
				342 3872
				347 3864
				347 3856
				343 3849
				345 3843
				347 3837
				347 3831
				352 3826
				352 3821
				355 3816
				357 3811
				360 3807
				362 3803
				365 3800
				367 3796
				370 3793
				373 3790
				377 3788
				380 3786
				383 3784
				388 3782
				393 3779
				400 3777
				408 3775
				417 3772
				423 3768
				433 3765
				445 3761
				455 3756
				467 3751
				480 3745
				493 3738
				507 3731
				523 3723
				542 3715
				563 3708
				585 3701
				615 3698
				653 3694
				697 3688
				753 3678
				813 3656
				883 3611>;

	r_profile_t1_5_num = <80>;
	r_profile_t1_5 = <203 4312
				203 4294
				203 4278
				205 4263
				205 4249
				205 4234
				203 4220
				205 4207
				205 4193
				205 4180
				205 4166
				207 4154
				207 4140
				208 4128
				208 4115
				210 4103
				208 4090
				212 4080
				217 4071
				222 4061
				218 4046
				215 4029
				213 4013
				212 3999
				213 3989
				215 3981
				217 3974
				215 3965
				215 3956
				213 3945
				210 3934
				205 3922
				200 3909
				197 3898
				192 3887
				188 3877
				187 3868
				185 3860
				187 3853
				187 3847
				187 3841
				188 3835
				187 3829
				190 3825
				190 3820
				190 3815
				192 3811
				193 3807
				193 3803
				195 3799
				197 3796
				197 3792
				200 3790
				198 3786
				198 3783
				201 3781
				205 3780
				210 3777
				212 3774
				212 3770
				213 3767
				213 3762
				218 3759
				218 3754
				225 3750
				228 3744
				232 3737
				235 3730
				242 3723
				247 3714
				252 3705
				258 3699
				270 3697
				283 3695
				302 3692
				327 3685
				352 3664
				370 3612
				413 3537
				480 3423>;

	r_profile_t2_num = <80>;
	r_profile_t2 = <117 4308
				117 4291
				117 4276
				117 4261
				117 4247
				117 4233
				117 4219
				117 4205
				118 4192
				117 4178
				118 4165
				118 4152
				118 4139
				120 4126
				120 4113
				122 4101
				122 4088
				123 4077
				125 4066
				127 4055
				127 4043
				127 4029
				127 4016
				128 4005
				130 3996
				132 3987
				133 3978
				135 3969
				135 3959
				137 3949
				135 3938
				133 3927
				128 3914
				123 3901
				120 3889
				115 3878
				113 3869
				112 3861
				112 3854
				112 3847
				113 3842
				113 3836
				113 3831
				112 3825
				113 3821
				113 3816
				115 3812
				115 3808
				115 3804
				117 3800
				117 3796
				117 3793
				118 3790
				117 3786
				118 3783
				118 3780
				118 3776
				117 3772
				115 3767
				115 3763
				113 3758
				113 3753
				115 3749
				115 3745
				115 3740
				115 3735
				117 3728
				117 3721
				117 3714
				118 3706
				118 3696
				120 3693
				120 3691
				125 3690
				130 3688
				135 3681
				135 3654
				140 3599
				152 3523
				173 3407>;

	r_profile_t3_num = <80>;
	r_profile_t3 = <110 4310
				110 4302
				109 4286
				108 4271
				108 4256
				107 4242
				108 4228
				107 4214
				108 4200
				107 4186
				108 4173
				107 4160
				108 4147
				107 4134
				107 4121
				107 4108
				107 4096
				107 4084
				107 4071
				108 4060
				108 4048
				108 4037
				108 4026
				109 4015
				108 4004
				109 3994
				110 3984
				111 3974
				112 3964
				113 3955
				115 3945
				118 3936
				118 3925
				117 3913
				110 3899
				105 3886
				100 3875
				98 3866
				97 3859
				96 3852
				95 3845
				95 3839
				95 3834
				95 3828
				94 3823
				94 3818
				94 3813
				94 3809
				95 3805
				94 3800
				95 3797
				95 3793
				96 3790
				97 3786
				98 3783
				99 3779
				101 3774
				100 3766
				96 3757
				95 3752
				94 3746
				95 3741
				94 3736
				93 3731
				94 3726
				96 3722
				98 3716
				97 3709
				98 3702
				101 3696
				96 3687
				89 3679
				90 3678
				93 3677
				99 3675
				115 3672
				161 3660
				196 3618
				243 3557
				350 3472>;

	/* Battery 500 cycle ZCV */
	battery_profile_t1_500cycle = <0 4301
				2 4279
				4 4260
				6 4242
				8 4225
				10 4210
				13 4194
				15 4179
				17 4165
				19 4150
				21 4136
				23 4122
				25 4108
				27 4096
				29 4085
				31 4072
				33 4058
				35 4043
				38 4027
				40 4012
				42 3998
				44 3987
				46 3977
				48 3967
				50 3957
				52 3945
				54 3931
				56 3916
				58 3901
				60 3888
				63 3877
				65 3868
				67 3860
				69 3853
				71 3846
				73 3840
				75 3833
				77 3828
				79 3822
				81 3818
				83 3813
				85 3809
				88 3805
				90 3801
				92 3798
				94 3795
				96 3793
				98 3790
				100 3788
				102 3785>;

	battery_profile_t1_5_500cycle = <0 4300
				2 4280
				3 4263
				5 4247
				6 4232
				8 4217
				9 4202
				11 4188
				12 4173
				14 4160
				15 4146
				17 4132
				18 4119
				20 4106
				21 4092
				23 4080
				24 4070
				26 4058
				27 4044
				29 4028
				30 4013
				32 4000
				33 3989
				35 3980
				36 3971
				38 3960
				39 3947
				41 3932
				42 3914
				44 3900
				45 3889
				47 3880
				48 3871
				50 3863
				52 3856
				53 3849
				55 3843
				56 3837
				58 3831
				59 3826
				61 3820
				62 3816
				64 3811
				65 3806
				67 3802
				68 3798
				70 3794
				71 3791
				73 3788
				74 3785
				76 3782
				77 3778
				79 3774
				80 3770
				82 3765
				83 3760
				85 3755
				86 3750
				88 3745
				89 3740
				91 3733
				92 3725
				94 3718
				95 3709
				97 3701
				98 3695
				100 3691
				102 3688>;

	battery_profile_t2_500cycle = <0 4301
				1 4297
				3 4281
				4 4265
				6 4250
				7 4236
				8 4221
				10 4207
				11 4192
				13 4178
				14 4165
				15 4151
				17 4138
				18 4124
				19 4111
				21 4098
				22 4086
				24 4073
				25 4061
				26 4050
				28 4037
				29 4024
				31 4012
				32 4001
				33 3991
				35 3982
				36 3971
				38 3959
				39 3944
				40 3925
				42 3909
				43 3898
				44 3888
				46 3880
				47 3872
				49 3865
				50 3858
				51 3851
				53 3845
				54 3839
				56 3833
				57 3828
				58 3823
				60 3818
				61 3813
				63 3809
				64 3804
				65 3800
				67 3796
				68 3792
				69 3788
				71 3783
				72 3778
				74 3772
				75 3765
				76 3758
				78 3752
				79 3747
				81 3742
				82 3738
				83 3737
				85 3729
				86 3721
				88 3715
				89 3707
				90 3698
				92 3691
				93 3689
				94 3687
				96 3684
				97 3680
				99 3665
				100 3614>;

	battery_profile_t3_500cycle = <0 4298
				1 4288
				3 4273
				4 4258
				6 4243
				7 4229
				8 4215
				10 4200
				11 4187
				13 4173
				14 4160
				15 4146
				17 4133
				18 4120
				19 4107
				21 4095
				22 4082
				24 4070
				25 4057
				26 4046
				28 4034
				29 4023
				31 4012
				32 4001
				33 3990
				35 3980
				36 3969
				38 3958
				39 3943
				40 3923
				42 3910
				43 3899
				44 3889
				46 3881
				47 3874
				49 3866
				50 3859
				51 3852
				53 3846
				54 3840
				56 3834
				57 3828
				58 3823
				60 3818
				61 3813
				63 3808
				64 3804
				65 3799
				67 3795
				68 3791
				69 3786
				71 3780
				72 3769
				74 3760
				75 3752
				76 3746
				78 3739
				79 3733
				81 3728
				82 3723
				83 3718
				85 3711
				86 3704
				88 3697
				89 3689
				90 3680
				92 3676
				93 3674
				94 3672
				96 3669
				97 3664
				99 3635
				100 3578
				101 3499>;

	r_profile_t1_500cycle = <637 4301
				637 4279
				643 4260
				644 4242
				644 4225
				642 4210
				641 4194
				640 4179
				639 4165
				638 4150
				635 4136
				635 4122
				635 4108
				635 4096
				637 4085
				635 4072
				633 4058
				630 4043
				623 4027
				621 4012
				620 3998
				621 3987
				624 3977
				624 3967
				626 3957
				622 3945
				617 3931
				609 3916
				601 3901
				596 3888
				593 3877
				592 3868
				592 3860
				594 3853
				595 3846
				597 3840
				599 3833
				603 3828
				605 3822
				609 3818
				611 3813
				614 3809
				618 3805
				622 3801
				627 3798
				630 3795
				637 3793
				643 3790
				649 3788
				656 3785>;

	r_profile_t1_5_500cycle = <348 4300
				348 4280
				352 4263
				353 4247
				353 4232
				353 4217
				353 4202
				353 4188
				352 4173
				354 4160
				353 4146
				352 4132
				352 4119
				354 4106
				353 4092
				355 4080
				357 4070
				359 4058
				357 4044
				355 4028
				353 4013
				353 4000
				356 3989
				360 3980
				363 3971
				364 3960
				363 3947
				356 3932
				347 3914
				342 3900
				339 3889
				338 3880
				338 3871
				338 3863
				340 3856
				341 3849
				342 3843
				344 3837
				346 3831
				348 3826
				350 3820
				352 3816
				354 3811
				356 3806
				359 3802
				362 3798
				365 3794
				367 3791
				369 3788
				373 3785
				377 3782
				378 3778
				382 3774
				386 3770
				389 3765
				394 3760
				399 3755
				406 3750
				413 3745
				422 3740
				429 3733
				438 3725
				446 3718
				455 3709
				464 3701
				476 3695
				492 3691
				512 3688>;

	r_profile_t2_500cycle = <196 4301
				196 4297
				195 4281
				196 4265
				195 4250
				196 4236
				195 4221
				195 4207
				195 4192
				195 4178
				195 4165
				195 4151
				195 4138
				194 4124
				195 4111
				194 4098
				195 4086
				195 4073
				196 4061
				198 4050
				199 4037
				199 4024
				199 4012
				198 4001
				200 3991
				204 3982
				208 3971
				210 3959
				209 3944
				198 3925
				189 3909
				186 3898
				182 3888
				181 3880
				181 3872
				180 3865
				180 3858
				179 3851
				180 3845
				181 3839
				181 3833
				181 3828
				182 3823
				182 3818
				183 3813
				184 3809
				185 3804
				186 3800
				186 3796
				187 3792
				188 3788
				189 3783
				189 3778
				189 3772
				189 3765
				189 3758
				189 3752
				189 3747
				190 3742
				173 3738
				203 3737
				202 3729
				203 3721
				207 3715
				212 3707
				208 3698
				206 3691
				211 3689
				218 3687
				229 3684
				255 3680
				313 3665
				364 3614>;

	r_profile_t3_500cycle = <140 4298
				140 4288
				139 4273
				139 4258
				140 4243
				139 4229
				139 4215
				139 4200
				139 4187
				139 4173
				139 4160
				139 4146
				139 4133
				139 4120
				139 4107
				140 4095
				139 4082
				140 4070
				139 4057
				141 4046
				141 4034
				141 4023
				142 4012
				142 4001
				144 3990
				146 3980
				149 3969
				153 3958
				153 3943
				142 3923
				136 3910
				133 3899
				132 3889
				132 3881
				130 3874
				129 3866
				130 3859
				130 3852
				129 3846
				129 3840
				129 3834
				129 3828
				129 3823
				129 3818
				130 3813
				129 3808
				132 3804
				131 3799
				132 3795
				133 3791
				135 3786
				137 3780
				136 3769
				133 3760
				132 3752
				132 3746
				131 3739
				129 3733
				130 3728
				130 3723
				132 3718
				133 3711
				133 3704
				136 3697
				136 3689
				129 3680
				126 3676
				127 3674
				130 3672
				139 3669
				175 3664
				223 3635
				265 3578
				348 3499>;
};
