/*************************
 * Customized Battery Setting dtsi file
*************************/
&bat_comm {
	/* cust_charging.h */
	/* Linear Charging Threshold */
	v_pre2cc_thres = <3400>;   /* unit: mV */
	v_cc2topoff_thres = <4050>;
	recharging_voltage = <4110>;
	charging_full_current = <150>; /* unit: mA */

	/* Charging Current Setting */
	usb_charger_current = <50000>;	/* Unit: 0.01 mA */
	ac_charger_input_current = <100000>;	/* Unit: 0.01 mA */
	ac_charger_current = <120000>;	/* Unit: 0.01 mA */
	non_std_ac_charger_input_current = <100000>;	/* Unit: 0.01 mA */
	non_std_ac_charger_current = <120000>;	/* Unit: 0.01 mA */
	charging_host_charger_current = <50000>;	/* Unit: 0.01 mA */
	apple_0_5a_charger_current = <50000>;	/* Unit: 0.01 mA */
	apple_1_0a_charger_current = <100000>;	/* Unit: 0.01 mA */
	apple_2_1a_charger_current = <210000>;	/* Unit: 0.01 mA */

	/* Battery Temperature Protection */
	mtk_temperature_recharge_support = <1>;
	max_charge_temperature = <60>;
	max_charge_temperature_minus_x_degree = <60>;
	min_charge_temperature = <0>;
	min_charge_temperature_plus_x_degree = <6>;

	/* charger error check */
	bat_low_temp_protect_enable = <0>;
	v_charger_enable = <0>;	/* 1:on , 0:off */
	v_charger_max = <6500>;	/* unit: mV */
	v_charger_min = <4400>;

	/*  Tracking TIME */
	onehundred_percent_tracking_time = <10>;	/* Unit: second */
	npercent_tracking_time = <20>;	/* Unit: second */
	sync_to_real_tracking_time = <60>;	/* Unit: second */
	v_0percent_tracking = <3400>;	/* Unit: mV */

	/* High battery support */
	high_battery_voltage_support = <0>;

	/* JEITA related setting */
	mtk_jeita_standard_support=<1>;
	cust_soc_jeita_sync_time = <30>; /* Unit: second */
	jeita_recharge_voltage = <4110>; /* Unit: mV */
	jeita_temp_above_pos_60_cv_voltage = <4100000>; /* Unit: 0.001mV */
	jeita_temp_pos_45_to_pos_60_cv_voltage = <4100000>; /* Unit: 0.001mV */
	jeita_temp_pos_10_to_pos_45_cv_voltage = <4200000>; /* Unit: 0.001mV */
	jeita_temp_pos_0_to_pos_10_cv_voltage = <4200000>; /* Unit: 0.001mV */
	jeita_temp_neg_10_to_pos_0_cv_voltage = <4200000>; /* Unit: 0.001mV */
	jeita_temp_below_neg_10_cv_voltage = <4200000>; /* Unit: 0.001mV */

	/* For JEITA Linear Charging only */
	jeita_neg_10_to_pos_0_full_current = <120>; /* Unit: mA */
	jeita_temp_pos_45_to_pos_60_recharge_voltage = <4000>; /* Unit: mV */
	jeita_temp_pos_10_to_pos_45_recharge_voltage = <4100>; /* Unit: mV */
	jeita_temp_pos_0_to_pos_10_recharge_voltage = <4100>; /* Unit: mV */
	jeita_temp_neg_10_to_pos_0_recharge_voltage = <4100>; /* Unit: mV */
	jeita_temp_pos_45_to_pos_60_cc2topoff_threshold = <4050>; /* Unit: mV */
	jeita_temp_pos_10_to_pos_45_cc2topoff_threshold = <4050>; /* Unit: mV */
	jeita_temp_pos_0_to_pos_10_cc2topoff_threshold = <4050>; /* Unit: mV */
	jeita_temp_neg_10_to_pos_0_cc2topoff_threshold = <4050>; /* Unit: mV */
};

&bat_meter{

	/* cust_pmic.h */
	vbat_channel_number = <6>;
	isense_channel_number = <7>;
	vbattemp_channel_number = <5>;
	vcharger_channel_number = <4>;
	swchr_power_path = <1>;
	external_swchr_support = <1>;

	vbat_internal_charging = <7>;
	isense_internal_charging = <6>;

	/* cust_battery_meter.h */
	/* ADC resistor  */
	r_bat_sense = <4>;
	r_i_sense = <4>;
	r_charger_1 = <330>;
	r_charger_2 = <39>;
	temperature_t0 = <110>;
	temperature_t1 = <0>;
	temperature_t1_5 = <10>;
	temperature_t2 = <25>;
	temperature_t3 = <50>;
	temperature_t = <255>;	/* this should be fixed, never change the value */
	fg_meter_resistance = <0>;

	/* Qmax for 0mA battery 0*/
	q_max_pos_50 = <4689>;
	q_max_pos_25 = <4923>;
	q_max_pos_10 = <4635>;
	q_max_pos_0 = <4320>;
	q_max_neg_10 = <4050>;
	/* Qmax for 400mA, said high current battery 0*/
	q_max_pos_50_h_current = <4573>;
	q_max_pos_25_h_current = <4829>;
	q_max_pos_10_h_current = <4572>;
	q_max_pos_0_h_current = <3777>;
	q_max_neg_10_h_current = <2633>;

	/* Qmax for 0mA battery 1 */
	q_max_pos_50_1 = <4644>;
	q_max_pos_25_1 = <4801>;
	q_max_pos_10_1 = <4536>;
	q_max_pos_0_1 = <4536>;
	q_max_neg_10_1 = <4374>;
	/* Qmax for 400mA, said high current battery 1*/
	q_max_pos_50_h_current_1 = <4507>;
	q_max_pos_25_h_current_1 = <4706>;
	q_max_pos_10_h_current_1 = <4453>;
	q_max_pos_0_h_current_1 = <4404>;
	q_max_neg_10_h_current_1 = <4166>;

	/* Qmax_500cycle for 0mA battery 0*/
	q_max_pos_50_500cycle = <4543>;
	q_max_pos_25_500cycle = <4536>;
	q_max_pos_10_500cycle = <4607>;
	q_max_pos_0_500cycle = <4574>;
	q_max_neg_10_500cycle = <4204>;
	/* Qmax_500cycle for 600mA, high current battery 0*/
	q_max_pos_50_h_current_500cycle = <4510>;
	q_max_pos_25_h_current_500cycle = <4495>;
	q_max_pos_10_h_current_500cycle = <4466>;
	q_max_pos_0_h_current_500cycle = <4210>;
	q_max_neg_10_h_current_500cycle = <1426>;

	/* Qmax_500cycle for 0mA battery 1*/
	q_max_pos_50_500cycle_1 = <4480>;
	q_max_pos_25_500cycle_1 = <4510>;
	q_max_pos_10_500cycle_1 = <4497>;
	q_max_pos_0_500cycle_1 = <4550>;
	q_max_neg_10_500cycle_1 = <4485>;
	/* Qmax_500cycle for 600mA, high current battery 1*/
	q_max_pos_50_h_current_500cycle_1 = <4440>;
	q_max_pos_25_h_current_500cycle_1 = <4470>;
	q_max_pos_10_h_current_500cycle_1 = <4447>;
	q_max_pos_0_h_current_500cycle_1 = <4476>;
	q_max_neg_10_h_current_500cycle_1 = <4324>;

	/* Discharge percentage, 1: D5, 0: D2 */
	oam_d5 = <0>;

	change_tracking_point = <1>;
	/* SW OCV tracking setting */
	cust_tracking_point = <14>;
	cust_r_sense = <200>;
	cust_hw_cc = <0>;
	aging_tuning_value = <100>;
	cust_r_fg_offset = <0>;
	ocv_board_compesate = <0>;
	r_fg_board_base = <1000>;
	r_fg_board_slope = <1000>;
	car_tune_value = <100>;

	/* HW Fuel gague  */
	current_detect_r_fg = <10>;	/* Unit: mA */
	minerroroffset = <1000>;
	fg_vbat_average_size = <18>;
	r_fg_value = <10>;	/* Unit: mOhm */

	cust_poweron_delta_capacity_tolrance = <80>;
	cust_poweron_low_capacity_tolrance = <5>;
	cust_poweron_max_vbat_tolrance = <70>;
	cust_poweron_delta_vbat_tolrance = <60>;
	cust_poweron_delta_hw_sw_ocv_capacity_tolrance = <10>;

	/* Fixed battery temperature */
	fixed_tbat_25 = <0>;
	/* Dynamic change wake up period of battery thread when suspend */
	vbat_normal_wakeup = <3600>;	/* Unit: mV */
	vbat_low_power_wakeup = <3500>;	/* Unit: mV */
	normal_wakeup_period = <5400>;	/* Unit: second */
	low_power_wakeup_period = <300>;	/* Unit: second */
	close_poweroff_wakeup_period = <30>;	/* Unit: second */

	rbat_pull_up_r = <61900>;
	rbat_pull_down_r = <107000>;
	rbat_pull_up_volt = <1800>;

	step_of_qmax = <60>; /* Unit: mAh */

	batt_temperature_table_num = <17>;
	batt_temperature_table = <
				(-20) 499900
				(-15) 371600
				(-10) 278700
				(-5) 210800
				0 160800
				5 123800
				10 96030
				15 75100
				20 59190
				25 47000
				30 37590
				35 30270
				40 24540
				45 20020
				50 16430
				55 13570
				60 11270>;

	/* dod ocv */
	battery_profile_t0_num = <80>;
	battery_profile_t0 = <0 4167
				1 4114
				3 4079
				4 4053
				5 4026
				7 3997
				8 3975
				9 3964
				11 3958
				12 3952
				13 3948
				15 3943
				16 3938
				17 3934
				19 3928
				20 3923
				21 3917
				23 3910
				24 3904
				25 3897
				27 3889
				28 3881
				29 3872
				31 3864
				32 3855
				33 3848
				35 3841
				36 3834
				37 3828
				39 3823
				40 3819
				41 3815
				43 3811
				44 3807
				45 3804
				47 3801
				48 3798
				49 3796
				51 3794
				52 3792
				53 3791
				55 3790
				56 3788
				57 3787
				59 3786
				60 3785
				61 3783
				63 3782
				64 3780
				65 3778
				67 3776
				68 3775
				69 3772
				71 3770
				72 3768
				73 3765
				75 3762
				76 3759
				77 3755
				79 3752
				80 3748
				81 3743
				83 3739
				84 3732
				85 3728
				87 3722
				88 3716
				89 3711
				91 3706
				92 3702
				93 3699
				95 3694
				96 3688
				97 3677
				99 3653
				100 3609
				100 3609
				100 3609
				100 3609
				100 3609>;
	battery_profile_t0_num_1 = <80>;
	battery_profile_t0_1 = <0 4163
				1 4163
				2 4143
				4 4120
				5 4088
				6 4066
				7 4052
				9 4041
				10 4030
				11 4021
				12 4012
				14 4004
				15 3996
				16 3988
				17 3980
				19 3973
				20 3965
				21 3958
				22 3951
				23 3944
				25 3937
				26 3930
				27 3924
				28 3917
				30 3910
				31 3904
				32 3897
				33 3890
				35 3883
				36 3876
				37 3869
				38 3862
				40 3855
				41 3849
				42 3843
				43 3837
				44 3832
				46 3827
				47 3822
				48 3818
				49 3814
				51 3811
				52 3807
				53 3804
				54 3801
				56 3798
				57 3796
				58 3794
				59 3791
				60 3789
				62 3788
				63 3786
				65 3782
				67 3781
				69 3777
				70 3776
				72 3774
				73 3771
				74 3769
				75 3766
				77 3763
				78 3759
				79 3755
				80 3750
				81 3744
				83 3738
				84 3731
				85 3724
				86 3715
				88 3706
				89 3696
				90 3686
				91 3678
				93 3671
				94 3662
				95 3651
				96 3632
				98 3594
				99 3530
				100 3437>;

	battery_profile_t1_num = <80>;
	battery_profile_t1 = <0 4164
				1 4111
				3 4077
				4 4049
				5 4021
				6 4003
				8 3990
				9 3980
				10 3972
				11 3966
				13 3961
				14 3957
				15 3954
				16 3951
				18 3947
				19 3943
				20 3938
				21 3932
				23 3926
				24 3920
				25 3914
				26 3908
				28 3902
				29 3895
				30 3889
				31 3882
				33 3874
				34 3865
				35 3856
				36 3848
				38 3840
				39 3833
				40 3827
				41 3822
				43 3817
				44 3813
				45 3810
				46 3806
				48 3803
				49 3801
				50 3798
				51 3796
				53 3794
				54 3792
				55 3790
				56 3789
				58 3788
				59 3787
				60 3786
				61 3786
				63 3785
				65 3783
				66 3782
				68 3781
				69 3780
				70 3778
				71 3776
				73 3774
				74 3772
				75 3769
				76 3766
				78 3763
				79 3760
				80 3755
				81 3750
				83 3745
				84 3739
				85 3733
				86 3726
				88 3719
				89 3711
				90 3706
				91 3703
				93 3700
				94 3697
				95 3694
				96 3687
				98 3671
				99 3630
				100 3567>;
	battery_profile_t1_num_1 = <80>;
	battery_profile_t1_1 = <0 4179
				1 4132
				2 4106
				4 4090
				5 4077
				6 4066
				7 4056
				8 4045
				10 4036
				11 4027
				12 4019
				13 4010
				14 4002
				15 3993
				17 3985
				18 3978
				19 3971
				20 3964
				21 3957
				23 3951
				24 3943
				25 3937
				26 3931
				27 3924
				29 3918
				30 3912
				31 3905
				32 3898
				33 3892
				35 3885
				36 3878
				37 3871
				38 3864
				39 3857
				40 3850
				42 3843
				43 3837
				44 3831
				45 3825
				46 3821
				48 3816
				49 3812
				50 3808
				51 3804
				52 3801
				54 3798
				55 3795
				56 3793
				57 3790
				58 3788
				60 3786
				62 3783
				64 3780
				65 3778
				68 3776
				70 3773
				71 3771
				74 3766
				75 3763
				76 3760
				77 3756
				79 3752
				80 3747
				81 3742
				82 3736
				83 3730
				85 3723
				86 3715
				87 3708
				88 3698
				89 3687
				90 3677
				92 3671
				93 3664
				94 3657
				95 3648
				96 3628
				98 3583
				99 3519
				100 3431>;

	battery_profile_t1_5_num = <80>;
	battery_profile_t1_5 = <0 4178
				1 4119
				2 4104
				3 4092
				5 4086
				6 4082
				7 4076
				8 4066
				9 4048
				10 4025
				12 4007
				13 3994
				14 3977
				15 3971
				16 3966
				17 3963
				19 3960
				20 3958
				21 3953
				22 3948
				23 3942
				24 3936
				26 3929
				27 3923
				28 3918
				29 3912
				30 3906
				31 3900
				33 3895
				34 3889
				35 3883
				36 3876
				37 3869
				38 3860
				40 3850
				41 3840
				42 3833
				43 3826
				44 3821
				45 3817
				47 3813
				48 3809
				49 3806
				50 3803
				51 3800
				52 3798
				54 3795
				55 3793
				57 3789
				58 3787
				59 3785
				61 3784
				63 3783
				65 3782
				68 3780
				70 3778
				72 3775
				73 3773
				75 3770
				76 3767
				77 3763
				78 3760
				79 3756
				80 3752
				82 3746
				83 3740
				84 3733
				85 3727
				86 3720
				87 3711
				89 3704
				90 3701
				91 3699
				93 3696
				94 3693
				96 3684
				97 3646
				98 3587
				99 3506
				100 3379>;
	battery_profile_t1_5_num_1 = <80>;
	battery_profile_t1_5_1 = <0 4179
				1 4128
				2 4113
				4 4100
				5 4089
				6 4078
				7 4068
				8 4058
				10 4049
				11 4040
				12 4031
				13 4022
				14 4014
				15 4006
				17 3998
				18 3990
				19 3983
				20 3975
				21 3968
				23 3961
				24 3954
				25 3948
				26 3941
				27 3935
				29 3929
				30 3922
				31 3916
				32 3910
				33 3904
				35 3897
				36 3891
				37 3884
				38 3877
				39 3869
				40 3862
				42 3855
				43 3848
				44 3841
				45 3835
				46 3829
				48 3824
				49 3819
				50 3814
				51 3811
				52 3807
				54 3804
				55 3800
				56 3798
				57 3795
				58 3793
				60 3790
				61 3788
				63 3784
				65 3781
				67 3780
				69 3777
				71 3774
				74 3770
				75 3767
				76 3763
				77 3759
				79 3754
				80 3750
				81 3746
				82 3742
				83 3736
				85 3730
				86 3723
				87 3717
				88 3710
				89 3701
				90 3690
				92 3682
				93 3677
				94 3671
				95 3664
				96 3656
				98 3635
				99 3591
				100 3532>;

	battery_profile_t2_num = <80>;
	battery_profile_t2 = <0 4177
				1 4157
				2 4139
				3 4127
				4 4115
				5 4104
				7 4094
				8 4084
				9 4076
				10 4071
				11 4067
				12 4060
				13 4047
				14 4027
				15 4009
				16 3995
				18 3985
				19 3978
				20 3971
				21 3967
				22 3965
				23 3963
				24 3958
				25 3951
				26 3944
				27 3938
				29 3932
				30 3925
				31 3919
				32 3913
				33 3908
				34 3902
				35 3896
				36 3891
				37 3885
				38 3880
				39 3873
				41 3866
				42 3857
				43 3845
				44 3835
				45 3827
				46 3821
				47 3816
				48 3812
				49 3808
				50 3805
				52 3801
				53 3798
				55 3793
				57 3788
				59 3783
				61 3779
				64 3776
				66 3774
				68 3772
				70 3770
				72 3767
				73 3764
				75 3761
				76 3759
				77 3755
				78 3751
				79 3746
				81 3739
				82 3735
				83 3729
				84 3722
				86 3716
				87 3710
				88 3702
				89 3693
				90 3690
				92 3687
				94 3684
				95 3680
				97 3657
				98 3609
				99 3544
				100 3450>;
	battery_profile_t2_num_1 = <80>;
	battery_profile_t2_1 = <0 4179
				1 4157
				2 4140
				3 4125
				4 4111
				6 4100
				7 4089
				8 4078
				9 4069
				10 4059
				11 4049
				12 4040
				13 4031
				15 4023
				16 4014
				17 4006
				18 3998
				19 3990
				20 3982
				21 3975
				22 3968
				24 3961
				25 3954
				26 3947
				27 3940
				28 3934
				29 3928
				30 3922
				31 3916
				33 3910
				34 3904
				35 3898
				36 3892
				37 3885
				38 3879
				39 3872
				40 3865
				42 3857
				43 3849
				44 3842
				45 3834
				46 3828
				47 3823
				48 3817
				49 3813
				51 3808
				52 3804
				54 3797
				55 3794
				57 3789
				60 3784
				63 3778
				65 3774
				67 3772
				69 3770
				71 3767
				73 3761
				74 3757
				75 3752
				76 3747
				78 3743
				79 3738
				81 3731
				82 3726
				83 3720
				84 3714
				85 3706
				87 3701
				88 3692
				89 3684
				90 3674
				91 3671
				92 3665
				93 3660
				94 3652
				96 3637
				97 3601
				98 3549
				99 3482
				100 3392>;

	battery_profile_t3_num = <80>;
	battery_profile_t3 = <0 4179
				1 4140
				2 4119
				3 4104
				5 4092
				6 4086
				7 4082
				8 4077
				9  4067
				10 4048
				12 4025
				13 4007
				14 3994
				15 3978
				16 3972
				17 3967
				18 3964
				20 3960
				21 3958
				22 3954
				23 3948
				24 3943
				25 3936
				26 3930
				28 3924
				29 3918
				30 3912
				31 3907
				32 3900
				33 3895
				35 3890
				36 3883
				37 3877
				38 3870
				39 3860
				40 3850
				41 3841
				43 3833
				44 3827
				45 3821
				46 3817
				47 3814
				48 3810
				50 3806
				51 3804
				52 3801
				53 3798
				54 3796
				55 3794
				56 3791
				58 3790
				59 3787
				61 3785
				63 3784
				66 3782
				68 3780
				70 3778
				73 3776
				74 3774
				75 3771
				76 3767
				77 3764
				78 3760
				79 3757
				81 3752
				82 3747
				83 3740
				84 3734
				85 3728
				86 3721
				88 3712
				89 3704
				90 3701
				93 3697
				94 3693
				96 3684
				97 3646
				98 3587
				99 3506
				100 3380>;
	battery_profile_t3_num_1 = <80>;
	battery_profile_t3_1 = <0 4183
				1 4151
				2 4128
				3 4113
				5 4100
				6 4089
				7 4078
				8 4068
				9 4058
				10 4049
				12 4040
				13 4031
				14 4022
				15 4014
				16 4006
				17 3998
				19 3990
				20 3983
				21 3975
				22 3968
				23 3961
				24 3954
				25 3948
				27 3941
				28 3935
				29 3929
				30 3922
				31 3916
				33 3910
				34 3904
				35 3897
				36 3891
				37 3884
				38 3877
				40 3869
				41 3862
				42 3855
				43 3848
				44 3841
				45 3835
				47 3829
				48 3824
				49 3819
				50 3814
				51 3811
				52 3807
				55 3800
				57 3795
				59 3790
				62 3786
				64 3783
				65 3781
				66 3780
				69 3777
				70 3776
				72 3772
				73 3770
				74 3767
				76 3763
				77 3759
				78 3754
				79 3750
				80 3746
				81 3742
				83 3736
				84 3730
				85 3723
				86 3717
				87 3710
				88 3701
				90 3690
				91 3682
				92 3677
				93 3671
				94 3664
				95 3656
				97 3635
				98 3591
				99 3532
				100 3454>;

	/* r ocv */
	r_profile_t0_num = <80>;
	r_profile_t0 = <323 4167
				323 4114
				309 4079
				319 4053
				370 4026
				413 3997
				436 3975
				445 3964
				453 3958
				459 3952
				465 3948
				472 3943
				480 3938
				486 3934
				490 3928
				491 3923
				492 3917
				495 3910
				494 3904
				497 3897
				493 3889
				492 3881
				477 3872
				464 3864
				451 3855
				463 3848
				450 3841
				439 3834
				429 3828
				421 3823
				412 3819
				410 3815
				418 3811
				424 3807
				429 3804
				435 3801
				437 3798
				439 3796
				441 3794
				447 3792
				454 3791
				463 3790
				470 3788
				477 3787
				485 3786
				492 3785
				501 3783
				510 3782
				518 3780
				522 3778
				526 3776
				531 3775
				544 3772
				556 3770
				566 3768
				575 3765
				587 3762
				598 3759
				608 3755
				614 3752
				623 3748
				634 3743
				651 3739
				587 3732
				628 3728
				657 3722
				681 3716
				706 3711
				735 3706
				766 3702
				774 3699
				820 3694
				877 3688
				955 3677
				1044 3653
				1150 3609
				1150 3609
				1150 3609
				1150 3609
				1150 3609>;
	r_profile_t0_num_1 = <80>;
	r_profile_t0_1 = <247 4163
				247 4163
				259 4143
				285 4120
				290 4088
				286 4066
				287 4052
				291 4041
				295 4030
				299 4021
				302 4012
				304 4004
				306 3996
				308 3988
				309 3980
				312 3973
				312 3965
				314 3958
				311 3951
				307 3944
				304 3937
				299 3930
				295 3924
				292 3917
				288 3910
				285 3904
				282 3897
				280 3890
				281 3883
				283 3876
				284 3869
				285 3862
				285 3855
				284 3849
				284 3843
				285 3837
				287 3832
				289 3827
				291 3822
				293 3818
				295 3814
				296 3811
				298 3807
				300 3804
				301 3801
				300 3798
				299 3796
				298 3794
				299 3791
				301 3789
				301 3788
				302 3786
				303 3782
				303 3781
				300 3777
				299 3776
				300 3774
				276 3771
				283 3769
				287 3766
				289 3763
				290 3759
				291 3755
				291 3750
				290 3744
				290 3738
				291 3731
				294 3724
				298 3715
				303 3706
				309 3696
				319 3686
				334 3678
				353 3671
				376 3662
				409 3651
				454 3632
				515 3594
				607 3530
				793 3437>;

	r_profile_t1_num = <80>;
	r_profile_t1 = <200 4164
				200 4111
				202 4077
				202 4049
				189 4021
				181 4003
				179 3990
				177 3980
				178 3972
				179 3966
				183 3961
				186 3957
				190 3954
				193 3951
				196 3947
				198 3943
				200 3938
				196 3932
				204 3926
				205 3920
				205 3914
				206 3908
				206 3902
				206 3895
				205 3889
				203 3882
				200 3874
				195 3865
				190 3856
				184 3848
				180 3840
				177 3833
				175 3827
				173 3822
				172 3817
				172 3813
				172 3810
				173 3806
				173 3803
				174 3801
				175 3798
				176 3796
				177 3794
				178 3792
				180 3790
				183 3789
				186 3788
				189 3787
				192 3786
				196 3786
				200 3785
				209 3783
				215 3782
				220 3781
				226 3780
				227 3778
				238 3776
				243 3774
				211 3772
				258 3769
				266 3766
				274 3763
				283 3760
				292 3755
				302 3750
				313 3745
				324 3739
				337 3733
				349 3726
				362 3719
				376 3711
				393 3706
				419 3703
				452 3700
				495 3697
				549 3694
				617 3687
				706 3671
				820 3630
				974 3567>;
	r_profile_t1_num_1 = <80>;
	r_profile_t1_1 = <199 4179
				199 4132
				189 4106
				187 4090
				187 4077
				188 4066
				189 4056
				189 4045
				191 4036
				192 4027
				193 4019
				194 4010
				195 4002
				195 3993
				196 3985
				197 3978
				196 3971
				199 3964
				200 3957
				201 3951
				201 3943
				202 3937
				202 3931
				202 3924
				203 3918
				203 3912
				202 3905
				201 3898
				201 3892
				200 3885
				199 3878
				197 3871
				196 3864
				194 3857
				191 3850
				189 3843
				188 3837
				187 3831
				186 3825
				185 3821
				186 3816
				185 3812
				186 3808
				185 3804
				186 3801
				187 3798
				188 3795
				188 3793
				188 3790
				188 3788
				188 3786
				189 3783
				190 3780
				188 3778
				192 3776
				193 3773
				193 3771
				194 3766
				195 3763
				195 3760
				196 3756
				196 3752
				196 3747
				198 3742
				199 3736
				201 3730
				203 3723
				205 3715
				209 3708
				210 3698
				210 3687
				212 3677
				222 3671
				234 3664
				250 3657
				274 3648
				313 3628
				358 3583
				421 3519
				534 3431>;

	r_profile_t1_5_num = <80>;
	r_profile_t1_5 = <248 4178
				248 4119
				251 4104
				253 4092
				258 4086
				265 4082
				271 4076
				272 4066
				267 4048
				261 4025
				259 4007
				259 3994
				248 3977
				250 3971
				254 3966
				258 3963
				263 3960
				266 3958
				267 3953
				265 3948
				264 3942
				264 3936
				265 3929
				266 3923
				268 3918
				269 3912
				271 3906
				271 3900
				272 3895
				273 3889
				273 3883
				271 3876
				268 3869
				263 3860
				255 3850
				248 3840
				245 3833
				242 3826
				241 3821
				241 3817
				241 3813
				241 3809
				241 3806
				242 3803
				242 3800
				243 3798
				244 3795
				245 3793
				246 3789
				247 3787
				248 3785
				249 3784
				252 3783
				254 3782
				256 3780
				259 3778
				261 3775
				261 3773
				261 3770
				261 3767
				261 3763
				262 3760
				264 3756
				266 3752
				266 3746
				266 3740
				268 3733
				272 3727
				275 3720
				275 3711
				282 3704
				293 3701
				300 3699
				321 3696
				335 3693
				347 3684
				325 3646
				300 3587
				293 3506
				268 3379>;
	r_profile_t1_5_num_1 = <80>;
	r_profile_t1_5_1 = <148 4179
				148 4128
				146 4113
				144 4100
				145 4089
				145 4078
				146 4068
				146 4058
				147 4049
				147 4040
				148 4031
				149 4022
				150 4014
				150 4006
				164 3998
				165 3990
				165 3983
				165 3975
				165 3968
				166 3961
				166 3954
				167 3948
				167 3941
				167 3935
				167 3929
				167 3922
				167 3916
				167 3910
				167 3904
				166 3897
				166 3891
				165 3884
				163 3877
				161 3869
				159 3862
				156 3855
				153 3848
				151 3841
				149 3835
				147 3829
				145 3824
				144 3819
				143 3814
				143 3811
				142 3807
				142 3804
				142 3800
				143 3798
				142 3795
				142 3793
				143 3790
				143 3788
				143 3784
				143 3781
				142 3780
				144 3777
				145 3774
				147 3770
				148 3767
				149 3763
				148 3759
				148 3754
				149 3750
				151 3746
				154 3742
				156 3736
				158 3730
				160 3723
				163 3717
				168 3710
				167 3701
				162 3690
				163 3682
				171 3677
				183 3671
				205 3664
				259 3656
				328 3635
				393 3591
				500 3532>;

	r_profile_t2_num = <80>;
	r_profile_t2 = <99 4177
				99 4157
				88 4139
				90 4127
				90 4115
				92 4104
				92 4094
				88 4084
				90 4076
				92 4071
				96 4067
				106 4060
				108 4047
				106 4027
				101 4009
				93 3995
				87 3985
				84 3978
				86 3971
				86 3967
				88 3965
				90 3963
				92 3958
				94 3951
				96 3944
				98 3938
				101 3932
				101 3925
				101 3919
				103 3913
				106 3908
				106 3902
				108 3896
				110 3891
				112 3885
				112 3880
				112 3873
				111 3866
				104 3857
				97 3845
				88 3835
				81 3827
				80 3821
				77 3816
				73 3812
				77 3808
				73 3805
				76 3801
				73 3798
				76 3793
				76 3788
				76 3783
				74 3779
				74 3776
				74 3774
				76 3772
				77 3770
				78 3767
				79 3764
				78 3761
				80 3759
				81 3755
				81 3751
				76 3746
				82 3739
				84 3735
				88 3729
				87 3722
				88 3716
				91 3710
				94 3702
				81 3693
				82 3690
				84 3687
				99 3684
				133 3680
				181 3657
				223 3609
				287 3544
				434 3450>;
	r_profile_t2_num_1 = <80>;
	r_profile_t2_1 = <126 4179
				126 4157
				125 4140
				121 4125
				119 4111
				120 4100
				118 4089
				118 4078
				120 4069
				119 4059
				119 4049
				120 4040
				118 4031
				121 4023
				120 4014
				120 4006
				121 3998
				121 3990
				120 3982
				120 3975
				122 3968
				123 3961
				123 3954
				123 3947
				123 3940
				124 3934
				125 3928
				127 3922
				128 3916
				128 3910
				128 3904
				129 3898
				128 3892
				129 3885
				128 3879
				128 3872
				126 3865
				123 3857
				120 3849
				119 3842
				114 3834
				114 3828
				113 3823
				110 3817
				111 3813
				108 3808
				109 3804
				109 3797
				108 3794
				110 3789
				110 3784
				111 3778
				110 3774
				111 3772
				111 3770
				112 3767
				112 3761
				112 3757
				111 3752
				111 3747
				111 3743
				110 3738
				113 3731
				114 3726
				114 3720
				116 3714
				114 3706
				118 3701
				120 3692
				120 3684
				113 3674
				118 3671
				118 3665
				127 3660
				137 3652
				170 3637
				197 3601
				226 3549
				272 3482
				382 3392>;

	r_profile_t3_num = <80>;
	r_profile_t3 = <133 4179
				133 4140
				127 4119
				122 4104
				118 4092
				122 4086
				129 4082
				138 4077
				148 4067
				150 4048
				139 4025
				129 4007
				125 3994
				110 3978
				111 3972
				114 3967
				118 3964
				120 3960
				124 3958
				123 3954
				123 3948
				126 3943
				126 3936
				126 3930
				128 3924
				129 3918
				129 3912
				131 3907
				131 3900
				131 3895
				133 3890
				131 3883
				131 3877
				128 3870
				122 3860
				115 3850
				148 3841
				142 3833
				139 3827
				138 3821
				187 3817
				187 3814
				186 3810
				267 3806
				267 3804
				268 3801
				267 3798
				268 3796
				270 3794
				269 3791
				271 3790
				271 3787
				272 3785
				274 3784
				275 3782
				278 3780
				281 3778
				285 3776
				287 3774
				286 3771
				287 3767
				259 3764
				259 3760
				263 3757
				185 3752
				187 3747
				189 3740
				192 3734
				197 3728
				202 3721
				204 3712
				206 3704
				213 3701
				192 3697
				212 3693
				238 3684
				247 3646
				278 3587
				329 3506
				413 3380>;
	r_profile_t3_num_1 = <80>;
	r_profile_t3_1 = <157 4183
				157 4151
				148 4128
				146 4113
				144 4100
				145 4089
				145 4078
				146 4068
				146 4058
				147 4049
				147 4040
				148 4031
				149 4022
				150 4014
				150 4006
				164 3998
				165 3990
				165 3983
				165 3975
				165 3968
				166 3961
				166 3954
				167 3948
				167 3941
				167 3935
				167 3929
				167 3922
				167 3916
				167 3910
				167 3904
				166 3897
				166 3891
				165 3884
				163 3877
				161 3869
				159 3862
				156 3855
				153 3848
				151 3841
				149 3835
				147 3829
				145 3824
				144 3819
				143 3814
				143 3811
				142 3807
				142 3800
				142 3795
				143 3790
				142 3786
				142 3783
				143 3781
				142 3780
				144 3777
				145 3776
				146 3772
				147 3770
				148 3767
				149 3763
				148 3759
				148 3754
				149 3750
				151 3746
				154 3742
				156 3736
				158 3730
				160 3723
				163 3717
				168 3710
				167 3701
				162 3690
				163 3682
				171 3677
				183 3671
				205 3664
				259 3656
				328 3635
				393 3591
				500 3532
				813 3454>;

	/* Battery 500 cycle ZCV */
	battery_profile_t1_500cycle = <0 4199
				1 4185
				2 4172
				4 4161
				5 4150
				6 4139
				7 4130
				8 4120
				9 4112
				11 4108
				12 4105
				13 4100
				14 4089
				15 4069
				16 4042
				18 4020
				19 4006
				20 3995
				21 3987
				22 3980
				24 3974
				25 3969
				26 3965
				27 3963
				28 3960
				29 3956
				31 3951
				32 3944
				33 3938
				34 3931
				35 3924
				37 3915
				38 3906
				39 3895
				40 3884
				41 3874
				42 3865
				44 3857
				45 3850
				46 3844
				47 3839
				48 3835
				49 3831
				51 3827
				52 3823
				53 3819
				54 3816
				55 3813
				57 3810
				58 3807
				59 3805
				60 3802
				62 3799
				65 3797
				67 3792
				70 3786
				72 3779
				74 3766
				75 3783
				77 3779
				78 3774
				79 3770
				80 3766
				81 3762
				82 3757
				84 3751
				85 3744
				86 3736
				87 3728
				88 3720
				90 3715
				91 3711
				92 3708
				93 3704
				94 3699
				95 3688
				97 3658
				98 3601
				99 3517
				100 3381>;

	battery_profile_t1_5_500cycle = <0 4198
				1 4188
				2 4177
				4 4166
				5 4156
				6 4145
				7 4135
				8 4125
				9 4116
				11 4107
				12 4103
				13 4101
				14 4096
				15 4085
				16 4064
				18 4040
				19 4020
				20 4007
				21 3996
				22 3988
				23 3982
				25 3976
				26 3972
				27 3970
				28 3967
				29 3963
				30 3958
				32 3952
				33 3946
				34 3940
				35 3933
				36 3926
				37 3919
				39 3910
				40 3899
				41 3888
				42 3876
				43 3867
				44 3859
				46 3852
				47 3846
				48 3841
				49 3836
				50 3832
				51 3828
				53 3824
				54 3821
				55 3818
				57 3812
				58 3809
				60 3806
				61 3803
				63 3798
				66 3795
				68 3792
				70 3789
				73 3785
				74 3782
				75 3779
				76 3774
				77 3770
				78 3766
				80 3762
				81 3758
				82 3754
				83 3748
				84 3742
				85 3735
				87 3727
				88 3719
				89 3712
				90 3707
				91 3704
				94 3699
				95 3692
				96 3675
				97 3634
				98 3570
				99 3476
				100 3316>;

	battery_profile_t2_500cycle = <0 4177
				1 4164
				2 4152
				4 4141
				5 4131
				6 4120
				7 4110
				8 4100
				10 4090
				11 4081
				12 4075
				13 4072
				14 4069
				15 4058
				17 4040
				18 4018
				19 4001
				20 3988
				21 3979
				23 3972
				24 3966
				25 3962
				26 3960
				27 3957
				29 3951
				30 3945
				31 3938
				32 3932
				33 3925
				34 3919
				36 3913
				37 3906
				38 3898
				39 3890
				40 3879
				42 3866
				43 3855
				44 3846
				45 3838
				46 3832
				48 3827
				49 3822
				50 3818
				51 3813
				52 3809
				53 3805
				55 3802
				56 3799
				57 3795
				59 3790
				62 3784
				64 3779
				67 3774
				69 3770
				70 3766
				71 3764
				72 3760
				74 3755
				75 3751
				76 3746
				77 3741
				78 3737
				80 3734
				81 3731
				82 3727
				83 3721
				84 3714
				86 3708
				87 3700
				88 3691
				89 3684
				90 3681
				91 3680
				93 3678
				94 3676
				95 3671
				96 3650
				97 3600
				99 3530
				100 3429>;

	battery_profile_t3_500cycle = <0 4175
				1 4163
				2 4152
				4 4142
				5 4131
				6 4121
				7 4111
				8 4101
				9 4091
				11 4081
				12 4072
				13 4064
				14 4059
				15 4051
				17 4037
				18 4023
				19 4012
				20 4005
				21 4000
				23 3993
				24 3986
				25 3978
				26 3971
				27 3964
				28 3956
				30 3950
				31 3943
				32 3936
				33 3930
				34 3924
				36 3917
				37 3910
				38 3903
				39 3894
				40 3884
				42 3872
				43 3861
				44 3852
				45 3845
				46 3840
				47 3834
				49 3830
				50 3825
				51 3821
				52 3817
				53 3813
				55 3810
				56 3806
				57 3803
				58 3800
				59 3796
				61 3793
				63 3788
				65 3783
				68 3778
				70 3770
				72 3755
				74 3748
				75 3743
				76 3739
				77 3733
				78 3729
				79 3726
				81 3722
				82 3719
				83 3714
				84 3707
				85 3701
				87 3694
				88 3685
				89 3678
				90 3676
				91 3674
				93 3673
				94 3671
				95 3666
				96 3646
				97 3598
				98 3533
				100 3442>;

	r_profile_t1_500cycle = <292 4199
				291 4185
				293 4172
				294 4161
				296 4150
				296 4139
				298 4130
				296 4120
				297 4112
				304 4108
				318 4105
				329 4100
				334 4089
				330 4069
				317 4042
				312 4020
				313 4006
				313 3995
				317 3987
				318 3980
				321 3974
				323 3969
				327 3965
				333 3963
				338 3960
				341 3956
				343 3951
				344 3944
				346 3938
				348 3931
				347 3924
				347 3915
				343 3906
				337 3895
				333 3884
				328 3874
				323 3865
				323 3857
				323 3850
				320 3844
				323 3839
				325 3835
				328 3831
				328 3827
				332 3823
				333 3819
				336 3816
				340 3813
				344 3810
				346 3807
				349 3805
				351 3802
				359 3799
				364 3797
				121 3792
				119 3786
				119 3779
				114 3766
				290 3783
				386 3779
				391 3774
				398 3770
				404 3766
				410 3762
				416 3757
				424 3751
				431 3744
				439 3736
				447 3728
				456 3720
				466 3715
				485 3711
				509 3708
				539 3704
				579 3699
				623 3688
				667 3658
				723 3601
				810 3517
				953 3381>;

	r_profile_t1_5_500cycle = <201 4198
				201 4188
				202 4177
				203 4166
				203 4156
				204 4145
				204 4135
				205 4125
				203 4116
				201 4107
				204 4103
				214 4101
				223 4096
				225 4085
				222 4064
				215 4040
				211 4020
				211 4007
				210 3996
				212 3988
				212 3982
				214 3976
				216 3972
				220 3970
				225 3967
				228 3963
				230 3958
				232 3952
				234 3946
				236 3940
				238 3933
				241 3926
				241 3919
				240 3910
				236 3899
				229 3888
				223 3876
				218 3867
				216 3859
				213 3852
				213 3846
				212 3841
				213 3836
				213 3832
				214 3828
				215 3824
				216 3821
				217 3818
				220 3812
				221 3809
				222 3806
				224 3803
				227 3798
				229 3795
				233 3792
				235 3789
				237 3785
				238 3782
				238 3779
				239 3774
				240 3770
				241 3766
				245 3762
				248 3758
				253 3754
				254 3748
				259 3742
				263 3735
				268 3727
				271 3719
				276 3712
				281 3707
				292 3704
				325 3699
				350 3692
				380 3675
				404 3634
				436 3570
				495 3476
				644 3316>;

	r_profile_t2_500cycle = <117 4177
				117 4164
				119 4152
				120 4141
				121 4131
				120 4120
				120 4110
				120 4100
				121 4090
				120 4081
				119 4075
				122 4072
				126 4069
				126 4058
				124 4040
				123 4018
				123 4001
				122 3988
				122 3979
				123 3972
				121 3966
				123 3962
				126 3960
				128 3957
				127 3951
				129 3945
				130 3938
				132 3932
				133 3925
				135 3919
				139 3913
				142 3906
				143 3898
				144 3890
				142 3879
				136 3866
				132 3855
				128 3846
				126 3838
				126 3832
				125 3827
				124 3822
				121 3818
				121 3813
				121 3809
				121 3805
				122 3802
				128 3799
				128 3795
				130 3790
				130 3784
				131 3779
				133 3774
				133 3770
				132 3766
				132 3764
				131 3760
				129 3755
				129 3751
				128 3746
				128 3741
				128 3737
				129 3734
				130 3731
				132 3727
				132 3721
				131 3714
				131 3708
				131 3700
				130 3691
				129 3684
				129 3681
				131 3680
				133 3678
				137 3676
				144 3671
				147 3650
				144 3600
				146 3530
				155 3429>;

	r_profile_t3_500cycle = <101 4175
				101 4163
				101 4152
				101 4142
				101 4131
				101 4121
				101 4111
				102 4101
				101 4091
				101 4081
				102 4072
				103 4064
				104 4059
				104 4051
				103 4037
				103 4023
				103 4012
				104 4005
				104 4000
				104 3993
				104 3986
				104 3978
				105 3971
				106 3964
				107 3956
				108 3950
				109 3943
				109 3936
				110 3930
				112 3924
				112 3917
				115 3910
				116 3903
				117 3894
				116 3884
				112 3872
				109 3861
				107 3852
				105 3845
				105 3840
				104 3834
				103 3830
				104 3825
				103 3821
				103 3817
				103 3813
				104 3810
				105 3806
				105 3803
				105 3800
				105 3796
				106 3793
				107 3788
				108 3783
				110 3778
				109 3770
				103 3755
				103 3748
				104 3743
				104 3739
				104 3733
				103 3729
				105 3726
				104 3722
				105 3719
				105 3714
				105 3707
				105 3701
				104 3694
				105 3685
				103 3678
				104 3676
				104 3674
				107 3673
				108 3671
				112 3666
				109 3646
				109 3598
				113 3533
				121 3442>;

	battery_profile_t1_500cycle_1 = <0  4192
				1  4187
				2  4173
				4  4161
				5  4150
				6  4139
				7  4128
				8  4118
				9  4107
				11  4098
				12  4088
				13  4078
				14  4069
				15  4060
				17  4051
				18  4042
				19  4033
				20  4025
				21  4016
				23  4009
				24  4000
				25  3993
				26  3985
				27  3978
				28  3971
				30  3964
				31  3957
				32  3950
				33  3943
				34  3935
				36  3928
				37  3921
				38  3913
				39  3904
				40  3896
				41  3887
				43  3878
				44  3870
				45  3863
				46  3856
				47  3849
				49  3843
				50  3838
				51  3833
				52  3829
				53  3824
				54  3821
				56  3817
				57  3814
				58  3810
				59  3807
				62  3801
				64  3797
				65  3794
				68  3790
				70  3786
				71  3784
				73  3779
				75  3776
				76  3771
				77  3766
				78  3761
				79  3757
				81  3753
				82  3748
				83  3742
				84  3736
				85  3729
				86  3722
				88  3714
				89  3704
				90  3697
				91  3691
				92  3686
				94  3679
				95  3668
				96  3648
				97  3603
				98  3539
				100  3453>;

	battery_profile_t1_5_500cycle_1 = <0  4188
				1  4174
				2  4162
				4  4151
				5  4139
				6  4129
				7  4118
				8  4108
				10  4098
				11  4089
				12  4079
				13  4069
				14  4060
				16  4051
				17  4042
				18  4034
				19  4026
				20  4017
				22  4009
				23  4001
				24  3994
				25  3987
				26  3979
				28  3972
				29  3965
				30  3958
				31  3952
				32  3945
				34  3938
				35  3932
				36  3925
				37  3918
				38  3910
				40  3901
				41  3891
				42  3882
				43  3872
				44  3864
				46  3857
				47  3851
				48  3845
				49  3840
				50  3835
				52  3830
				53  3826
				54  3822
				55  3819
				56  3815
				58  3812
				59  3809
				60  3806
				61  3803
				64  3798
				66  3793
				67  3791
				70  3787
				72  3782
				73  3778
				74  3773
				76  3767
				77  3761
				78  3757
				79  3753
				80  3749
				82  3745
				83  3740
				84  3734
				85  3727
				86  3721
				87  3712
				89  3703
				90  3696
				91  3692
				92  3687
				93  3681
				95  3672
				96  3650
				97  3604
				98  3541
				100  3456>;

	battery_profile_t2_500cycle_1 = <0  4180
				1  4164
				2  4150
				4  4137
				5  4125
				6  4114
				7  4103
				8  4092
				10  4082
				11  4072
				12  4063
				13  4053
				14  4044
				16  4035
				17  4027
				18  4017
				19  4009
				20  4000
				22  3993
				23  3984
				24  3977
				25  3970
				26  3963
				28  3956
				29  3948
				30  3942
				31  3934
				32  3928
				34  3921
				35  3915
				36  3908
				37  3902
				38  3895
				40  3888
				41  3880
				42  3871
				43  3861
				44  3852
				45  3844
				47  3839
				48  3832
				49  3827
				50  3821
				51  3816
				53  3812
				54  3808
				55  3804
				57  3797
				59  3793
				61  3787
				63  3782
				66  3777
				67  3774
				68  3772
				69  3770
				71  3766
				72  3762
				73  3757
				74  3750
				75  3744
				77  3739
				78  3734
				79  3730
				80  3726
				81  3722
				83  3717
				84  3712
				85  3706
				86  3699
				87  3692
				89  3682
				90  3676
				91  3672
				92  3667
				93  3662
				95  3653
				96  3635
				97  3593
				98  3535
				100  3458>;

	battery_profile_t3_500cycle_1 = <0  4183
				1  4170
				2  4157
				4  4146
				5  4135
				6  4124
				7  4114
				8  4103
				10  4094
				11  4084
				12  4074
				13  4065
				14  4056
				16  4047
				17  4038
				18  4030
				19  4021
				20  4013
				22  4005
				23  3997
				24  3989
				25  3982
				26  3974
				28  3967
				29  3960
				30  3953
				31  3947
				32  3940
				34  3934
				35  3927
				36  3921
				37  3914
				39  3907
				40  3899
				41  3889
				42  3878
				43  3869
				45  3861
				46  3854
				47  3848
				48  3842
				49  3837
				51  3832
				52  3828
				53  3824
				54  3820
				57  3813
				59  3805
				61  3800
				64  3794
				65  3792
				66  3789
				67  3786
				69  3783
				70  3779
				71  3772
				72  3763
				73  3755
				75  3749
				76  3743
				77  3737
				78  3733
				79  3728
				81  3725
				82  3721
				83  3716
				84  3710
				85  3703
				87  3697
				88  3688
				89  3680
				90  3676
				91  3672
				93  3668
				94  3662
				95  3650
				96  3616
				97  3566
				99  3501
				100  3414>;

	r_profile_t1_500cycle_1 = <177  4192
				175  4187
				176  4173
				177  4161
				178  4150
				179  4139
				180  4128
				181  4118
				182  4107
				183  4098
				185  4088
				186  4078
				187  4069
				188  4060
				189  4051
				190  4042
				191  4033
				192  4025
				193  4016
				195  4009
				196  4000
				196  3993
				198  3985
				199  3978
				200  3971
				200  3964
				201  3957
				202  3950
				202  3943
				202  3935
				202  3928
				201  3921
				200  3913
				198  3904
				196  3896
				193  3887
				191  3878
				189  3870
				187  3863
				187  3856
				186  3849
				186  3843
				186  3838
				185  3833
				186  3829
				186  3824
				187  3821
				187  3817
				188  3814
				189  3810
				189  3807
				191  3801
				192  3797
				193  3794
				193  3790
				194  3786
				194  3784
				194  3779
				193  3776
				192  3771
				190  3766
				191  3761
				191  3757
				192  3753
				192  3748
				193  3742
				193  3736
				194  3729
				195  3722
				195  3714
				194  3704
				194  3697
				197  3691
				202  3686
				208  3679
				217  3668
				222  3648
				219  3603
				224  3539
				237  3453>;

	r_profile_t1_5_500cycle_1 = <123  4188
				134  4174
				135  4162
				135  4151
				136  4139
				137  4129
				137  4118
				139  4108
				139  4098
				141  4089
				141  4079
				142  4069
				142  4060
				144  4051
				144  4042
				145  4034
				147  4026
				147  4017
				149  4009
				149  4001
				150  3994
				151  3987
				152  3979
				153  3972
				154  3965
				154  3958
				156  3952
				156  3945
				157  3938
				158  3932
				158  3925
				158  3918
				157  3910
				155  3901
				151  3891
				148  3882
				145  3872
				144  3864
				144  3857
				143  3851
				143  3845
				143  3840
				143  3835
				143  3830
				143  3826
				143  3822
				144  3819
				144  3815
				145  3812
				146  3809
				146  3806
				147  3803
				148  3798
				149  3793
				150  3791
				150  3787
				149  3782
				147  3778
				146  3773
				144  3767
				143  3761
				143  3757
				145  3753
				145  3749
				146  3745
				146  3740
				146  3734
				146  3727
				147  3721
				148  3712
				146  3703
				147  3696
				148  3692
				150  3687
				155  3681
				160  3672
				160  3650
				156  3604
				159  3541
				165  3456>;

	r_profile_t2_500cycle_1 = <109  4180
				109  4164
				109  4150
				109  4137
				110  4125
				111  4114
				111  4103
				110  4092
				112  4082
				112  4072
				113  4063
				112  4053
				114  4044
				113  4035
				115  4027
				114  4017
				116  4009
				116  4000
				117  3993
				117  3984
				119  3977
				120  3970
				121  3963
				122  3956
				122  3948
				123  3942
				123  3934
				125  3928
				125  3921
				125  3915
				126  3908
				126  3902
				126  3895
				126  3888
				125  3880
				121  3871
				119  3861
				117  3852
				115  3844
				117  3839
				116  3832
				115  3827
				115  3821
				114  3816
				115  3812
				114  3808
				115  3804
				115  3797
				116  3793
				117  3787
				117  3782
				119  3777
				119  3774
				121  3772
				121  3770
				120  3766
				118  3762
				116  3757
				114  3750
				114  3744
				113  3739
				114  3734
				114  3730
				114  3726
				115  3722
				116  3717
				115  3712
				116  3706
				116  3699
				116  3692
				115  3682
				116  3676
				118  3672
				118  3667
				120  3662
				124  3653
				127  3635
				120  3593
				123  3535
				128  3458>;

	r_profile_t3_500cycle_1 = <97  4183
				97  4170
				97  4157
				97  4146
				97  4135
				98  4124
				98  4114
				98  4103
				98  4094
				99  4084
				99  4074
				99  4065
				99  4056
				100  4047
				100  4038
				101  4030
				101  4021
				102  4013
				102  4005
				102  3997
				103  3989
				103  3982
				104  3974
				106  3967
				105  3960
				106  3953
				108  3947
				108  3940
				108  3934
				109  3927
				110  3921
				111  3914
				111  3907
				110  3899
				107  3889
				104  3878
				103  3869
				103  3861
				103  3854
				102  3848
				102  3842
				103  3837
				103  3832
				103  3828
				103  3824
				103  3820
				104  3813
				104  3805
				106  3800
				107  3794
				108  3792
				109  3789
				108  3786
				109  3783
				108  3779
				105  3772
				103  3763
				103  3755
				104  3749
				103  3743
				103  3737
				104  3733
				104  3728
				104  3725
				104  3721
				105  3716
				105  3710
				105  3703
				105  3697
				105  3688
				105  3680
				105  3676
				106  3672
				107  3668
				109  3662
				111  3650
				108  3616
				109  3566
				113  3501
				118  3414>;
};
