## drivers/misc/mediatek/auxadc/Kconfig
```kconfig
config MTK_AUXADC
    tristate "MediaTek AUXADC driver"
    default y
    help
      AUXADC driver support for MediaTek SOC
      If you want to use MediaTek AUXADC driver, say Y or M here.If unsure, say N.

config AUXADC_NEED_POWER_ON
    tristate "MediaTek TABLET IC AUXADC driver"
    depends on MTK_AUXADC
    help
      AUXADC driver support for MediaTek TABLET ICs.
      If you want to use MediaTek TABLET ICs AUXADC driver, say Y or M here.If unsure, say N.

config AUXADC_NOT_CONTROL_APMIXED_BASE
    tristate "Support MediaTek ICs that don't need to control APMIXED_BASE"
    depends on MTK_AUXADC
    help
      AUXADC driver support for MediaTek IC which don't need to control APMIXED_BASE.
      If you don't want to use MediaTek AUXADC driver to control APMIXED_BASE for these IC, say Y or M here.If unsure, say N.
```

## drivers/misc/mediatek/base/power/Kconfig
```kconfig
config MTK_CLKMGR
	bool "Mediatek proprietary clock management"
	default n
	---help---
	  Mediatek proprietary clock management is used to operate
          the clocks. The clocks are composed of CG, MUX, PLL,
          non-MTCMOS. The operations of clocks are enabling,
          disabling, and querying status. If this config is not set,
          system will use COMMON_CLK instead.

config EXT_BUCK_I2C_LOW_SPD
	bool "Deep idle use low speed i2c for external buck"
	default n
```

## drivers/misc/mediatek/btcvsd/Kconfig
```kconfig
config MTK_BTCVSD
	bool "use btcvsd share buf driver"
	help
	  this config is for btcvsd driver.
	  when bt and audio use share buffer
	  to communicate,this config need to
	  enable.
```

## drivers/misc/mediatek/cmdq/Kconfig
```kconfig
config MTK_CMDQ
  bool CONFIG_MTK_CMDQ
  default n
  help
    CONFIG_MTK_CMDQ

config MTK_CMDQ_TAB
  bool CONFIG_MTK_CMDQ_TAB
  default n
  help
    CONFIG_MTK_CMDQ_TAB

config MTK_CMDQ_HIDE_ERROR_LOGS
  bool CONFIG_MTK_CMDQ_HIDE_ERROR_LOGS
  default n
  help
    CONFIG_MTK_CMDQ_HIDE_ERROR_LOGS
```

## drivers/misc/mediatek/emi_mpu/Kconfig
```kconfig
config MTK_EMI_MPU
	bool "EMI_MPU driver"
	help
	  This config enable/disable emi mpu driver.
	  This driver includes mpu protect api and
	  emi violation handler.
```

## drivers/misc/mediatek/gpu/Kconfig
```kconfig
#
# Copyright (C) 2016 MediaTek Inc.
#
# This program is free software; you can redistribute it and/or modify
# it under the terms of the GNU General Public License version 2 as
# published by the Free Software Foundation.
#
# This program is distributed in the hope that it will be useful,
# but WITHOUT ANY WARRANTY; without even the implied warranty of
# MERCHANTABILITY or FITNESS FOR A PARTICULAR PURPOSE.
# See http://www.gnu.org/licenses/gpl-2.0.html for more details.
#


config MTK_GPU_SUPPORT
	bool CONFIG_MTK_GPU_SUPPORT
	default n
	help
	  CONFIG_MTK_GPU_SUPPORT define if the gpu driver should be built in or not

config MTK_GPU_VERSION
	string CONFIG_MTK_GPU_VERSION
	default ""
	help
	  CONFIG_MTK_GPU_VERSION define which gpu ddk version will be used

config MTK_GPU_COMMON_DVFS_SUPPORT
  bool CONFIG_MTK_GPU_COMMON_DVFS_SUPPORT
  default n
  help
    CONFIG_MTK_GPU_COMMON_DVFS_SUPPORT define to use COMMON DVFS

config MTK_GPU_R5P0
	bool CONFIG_MTK_GPU_R5P0
	default n
	help
	  CONFIG_MTK_GPU_R5P0 define to use r5p0 drivers

config MTK_GPU_SAPPHIRE_LITE
        bool CONFIG_MTK_GPU_SAPPHIRE_LITE
        help
          Select Y here to enable mtk sapphire lite gpu support

config SW_SYNC64
        bool CONFIG_SW_SYNC64
        depends on SW_SYNC
        help
          A sync object driver that uses a 64bit counter to coordinate
          syncrhronization.  Useful when there is no hardware primitive backing
          the synchronization.

config MTK_GPU_SPM_DVFS_SUPPORT
  bool CONFIG_MTK_GPU_SPM_DVFS_SUPPORT
  default n
  help
    CONFIG_MTK_GPU_SPM_DVFS_SUPPORT define to use a SPM for GPU DVFS
```

## drivers/misc/mediatek/imgsensor/Kconfig
```kconfig
config CAMERA_MULTIMODAL
       bool "CONFIG_CAMERA_MULTIMODAL"
       default n
       help
          CONFIG_CAMERA_MULTIMODAL

config MTK_IMGSENSOR
	bool CONFIG_MTK_IMGSENSOR
	default n
	help
	  CONFIG_MTK_IMGSENSOR

source "drivers/misc/mediatek/imgsensor/src/Kconfig"
```

## drivers/misc/mediatek/leds/Kconfig
```kconfig
config MTK_LEDS
	tristate "MediaTek LED Support"
	depends on LEDS_CLASS
	---help---
	  This selects the MediaTek(R) LEDs connected to MediaTek chips.
	  If you want to use MediaTek(R) LEDs support, say Y or M here.
	  If unsure, say N.
	  Mediatek LED module includes backlight, indicate LED, keypad LED, button LED etc.

config LIGHTNESS_MAPPING_VALUE
	int "LIGHTNESS_MAPPING_VALUE"
	default 255
 	---help---
	  Backlight brightness mapping value, from 0 to 255.

config BACKLIGHT_SUPPORT_LP8557
	bool "Support backlight lp8557 board"

config ENABLE_BACKLIGHT_FACTOR
	tristate "MediaTek LED Support"
	default n
	---help---
	  Support backlight of factor,and adapt to different manufacturers to adajust to
	  the led brightness.

config MTK_LEDS_DEFAULT_BRIGHTNESS
	bool "MediaTek Led Support Default Brightness"
	default n
	---help---
	  Support setting a default brightness on boot for each led.
```

## drivers/misc/mediatek/power/Kconfig
```kconfig
# Power Related
config MTK_PMIC
	bool "MediaTek PMIC driver"
	---help---
	  MediaTek PMIC driver

config MTK_PMIC_KPOC_ONETOUCH
	bool "CONFIG_MTK_PMIC_KPOC_ONETOUCH"
	default n
	---help---
	  One click mute button to leave kpoc mod

choice
	prompt "Choose KPOC Long Press time"
	depends on MTK_PMIC && MTK_KERNEL_POWER_OFF_CHARGING
	config MTK_PMIC_KPOC_LONGPRESS_TIME_500MS
		bool "500"
	config MTK_PMIC_KPOC_LONGPRESS_TIME_0MS
		bool "0"
	config MTK_PMIC_KPOC_LONGPRESS_TIME_10S
		bool "10 sec"
endchoice
```

## drivers/misc/mediatek/sensors-1.0/accelerometer/Kconfig
```kconfig
config MTK_AUTO_DETECT_ACCELEROMETER
	bool "MTK_AUTO_DETECT_ACCELEROMETER"
	depends on MTK_SENSOR_SUPPORT
	help
	  one load to support different accelerometer sensor.
          If this option is set, multiple accelerometer driver
          can be configured at the same time, but only one
          can be probed.

config CUSTOM_KERNEL_ACCELEROMETER
	bool "CUSTOM_KERNEL_ACCELEROMETER"
	help
	  accelerometer sensor to detect accelerometer from x y z axis.
          If the platform is supported for acceleometer, this
          configuration should be configured, and the acceleometer
          driver configuration should be configured as well.

source "drivers/misc/mediatek/sensors-1.0/accelerometer/mc3410-new/Kconfig"
source "drivers/misc/mediatek/sensors-1.0/accelerometer/mc3416/Kconfig"
source "drivers/misc/mediatek/sensors-1.0/accelerometer/mpu6050g-new/Kconfig"
source "drivers/misc/mediatek/sensors-1.0/accelerometer/bma222E-new/Kconfig"
source "drivers/misc/mediatek/sensors-1.0/accelerometer/lsm6ds3g/Kconfig"
source "drivers/misc/mediatek/sensors-1.0/accelerometer/bma253/Kconfig"
source "drivers/misc/mediatek/sensors-1.0/accelerometer/bmi160_acc/Kconfig"
```

## drivers/misc/mediatek/sensors-1.0/accelerometer/bmi160_acc/Kconfig
```kconfig
config MTK_BMI160_ACC
	bool "Support Bosch BMI160 accelerometer for MediaTek package"
	help
	  It support different accelerometer sensor.
          If this option is set,
	  it will support
          BMI160 Accelerometer.
```

## drivers/misc/mediatek/sensors-1.0/accelerometer/mc3416/Kconfig
```kconfig
config MTK_MC3416
	bool "MC3416 for MediaTek package"
	default n
	help
	  It support different accelerometer sensor.
          If this option is set,
	  it will support
          MC3416 Accelerometer.
```
