## Documentation/devicetree/bindings/iio/light/tsl2540.txt
```
TSL2540 devicetree bindings

Required properties:
- compatible : "amstaos,tsl2540".
- reg : the chipselect index
- interrupts : interrupts generated by this device
- als_name : name for registration
- persist : ALS persistence filter
- als_gain : ALS gain setting
- als_gain_factor: specifies AGAINMAX and AGAINL for gain multiplier or division
  0 for no multiplication or division, 1 for 2x multiplication, 2 for division by 2.
  The default value is 0.
- az_iterations: auto zero setting
- als_deltap : threshold deltaP
- als_time : specifies integration time
- d_factor : device glass factor
- ch0_coef0 : lux 1 coefficient for channel 0
- ch1_coef0 : lux 1 coefficient for channel 1
- ch0_coef1 : lux 2 coefficient for channel 0
- ch1_coef1 : lux 2 coefficient for channel 1
- als_can_wake : als wake flag
- boot-on: enable the power state and mode


Example:
	taos_tsl2540: tsl2540@39 {
		compatible = "amstaos,tsl2540";
		reg = <0x39>;
		interrupts = <61>;
		als_name = "taos_als";
		persist = <18>;
		als_gain = <2>;
		als_gain_factor = <1>;
		az_iterations = <126>;
		als_deltap = <10>;
		als_time = <72>;
		d_factor = <41>;
		ch0_coef0 = <1000>;
		ch1_coef0 = <260>;
		ch0_coef1 = <800>;
		ch1_coef1 = <270>;
		als_can_wake = <0>;
		boot-on;
		#address-cells = <1>;
		#size-cells = <1>;
	};
```

## Documentation/devicetree/bindings/leds/leds-is31fl3236.txt
```
Binding for ISSI IS31FL3236 LED Driver

Required Properties:
	- compatible: "issi,is31fl3236"
	- reg: I2C Slave Address

Optional Properties:
	- setup-device: hard reset the device (toggle enable gpio)
	  and soft reset the device (write 0x1 into enable register)
	- enable-gpio: phandle to the gpio connected to the reset pin
	  Note: ignored if setup-device is not defined.
	- play-boot-animation: start kthread on probe to play boot animation
	  Note: you can still start the kthread by write 1 into the boot_animation
	  sysfs entry
	- channel-offset: Apply an offset to the starting channel for alignment

Example:
	1) Setup the driver on boot and play boot pattern on a device @ 0x3F:
	is31fl3236@3F {
		compatible = "issi,is31fl32326";
		reg = <0x3F>;
		setup-device;
		enable-gpio  = <&gpio 01 0>;
		play-boot-animation;
	};

	2) No setup and no boot animation on a device @ 0x3F:
	is31fl3236@3F {
		compatible = "issi,is31fl32326";
		reg = <0x3F>;
	};

	3) No setup and no boot animation.
	   Shift the starting led by one, which is 3-channels (R, G & B)
	is31fl3236@3F {
		compatible = "issi,is31fl32326";
		reg = <0x3F>;
		channel-offset = /bits/ 8 <3>;
	};
```

## Documentation/devicetree/bindings/misc/gating.txt
```
Device-Tree bindings for gating.c driver

Required properties:
	- compatible = "amazon-gating";
	- state-gpios: gpio to determine Gating state.
	- enable-gpios: gpio to enable Gating state.
	- input_event

Subnode properties:

	- label: Descriptive name of the key.
	- linux,code: Keycode to emit.

Optional subnode-properties:
	- debounce-interval: Debouncing interval time in milliseconds.
	  If not specified defaults to 5.
	- wakeup-source: MUTE button is enabled as wakeup source.

Example nodes:
		gating {
			compatible = "amazon-gating";
			state-gpios = <&pio 18 GPIO_ACTIVE_HIGH>;
			enable-gpios = <&pio 107 GPIO_ACTIVE_LOW>;
			status="okay";

			input_event {
				label = "mute";
				linux,code = <113>;
				debounce-interval = <200>;
				wakeup-source;
			};
		};

		...
```

## Documentation/devicetree/bindings/rfkill/rfkill-gpio.txt
```
GPIO controlled RFKILL devices

Required properties:
- compatible	: Must be "rfkill-gpio".
- rfkill-name	: Name of RFKILL device
- rfkill-type	: Type of RFKILL device: 1 for WiFi, 2 for BlueTooth, etc.
		  See include/uapi/linux/rfkill.h for all valid values
- gpios		: At most two GPIO phandles
- gpio-names	: Shall be "reset" or "shutdown", matching gpios.
		  If both are provided, the "reset" GPIO is toggled first.

Optional properties:
- clocks		: phandle to clock to enable/disable
- poweron-delay         : ms to delay after powering on device
- poweroff-delay        : ms to delay after powering off device
- default-state         : initial state set by driver (<1> = blocked <0> = unblocked)

Example:

	rfkill_bt {
		compatible = "rfkill-gpio";
		rfkill-name = "bluetooth";
		rfkill-type = <2>;
		gpios = <&pio 7 18 0>;
		gpio-names = "reset";
		clocks = <&clk_out_a>;
	};
```

## arch/arm/mach-mediatek/Kconfig
```kconfig
menuconfig ARCH_MEDIATEK
	bool "Mediatek MT65xx & MT81xx SoC"
	depends on ARCH_MULTI_V7
	select ARM_GIC
	select PINCTRL
	select MTK_TIMER
	select MFD_SYSCON
	help
	  Support for Mediatek MT65xx & MT81xx SoCs

if ARCH_MEDIATEK

config MACH_MT2701
	bool "MediaTek MT2701 SoCs support"
	default ARCH_MEDIATEK

config MACH_MT6589
	bool "MediaTek MT6589 SoCs support"
	default ARCH_MEDIATEK

config MACH_MT6592
	bool "MediaTek MT6592 SoCs support"
	default ARCH_MEDIATEK

config MACH_MT7623
	bool "MediaTek MT7623 SoCs support"
	default ARCH_MEDIATEK

config MACH_MT8127
	bool "MediaTek MT8127 SoCs support"
	default ARCH_MEDIATEK

config MACH_MT8135
	bool "MediaTek MT8135 SoCs support"
	default ARCH_MEDIATEK

endif

config MACH_MT6765
	bool "MediaTek MT6765"
	select GENERIC_TIME
	select GENERIC_CLOCKEVENTS
	select ARCH_HAS_CPUFREQ
	select ARM_AMBA
	select CPU_V7
	select HAVE_SMP
	select IRQ_DOMAIN
	select IRQ_DOMAIN_DEBUG
	select GENERIC_SCHED_CLOCK
	select ARMV7_COMPAT
	select ARMV7_COMPAT_CPUINFO
	select CPU_IDLE
	select PINCTRL
	select PINCTRL_MT6765
	select MFD_SYSCON
	select KERNEL_MODE_NEON
	select MTK_BASE_POWER
	select MTK_GIC_V3_EXT
	select MTK_SYSIRQ
	select MTK_TIMER_V1
	select MTK_TIMER_TIMESYNC
	select ARM_GIC_V3
	select POWER_SUPPLY
	select MTK_BOUNCING_CHECK
	select MTK_LM_MODE if !MTK_GMO_RAM_OPTIMIZE
	select MTK_DRAMC
	select PM_DEVFREQ
	select MTK_EMI
	select MTK_SYS_CIRQ
	select ARM_ERRATA_855873
	select MTK_GIC_TARGET_ALL
	select FAST_CIRQ_CLONE_FLUSH
	select MTK_DEBUG_LATCH
	select MTK_DFD_INTERNAL_DUMP
	select MTK_PLAT_SRAM_FLAG
	select MTK_L2C_PARITY_CHECK
	select MTK_SYSTRACKER_V2
	select ARM_CRYPTO
	select CRYPTO_SHA2_ARM_CE
	select CRYPTO_AES_ARM_CE
	help
	  This enables support for MediaTek MT6765
	  Highly power-efficient, performance-oriented 4G LTE processor for premium,
	  thin-design smartphones. MT6765 also offers significant multitasking and
	  multimedia improvements.

config MACH_MT8163
	bool "MediaTek MT8163"
	select ARCH_MEDIATEK
	select SPARSE_IRQ
	select ARM_KERNMEM_PERMS
	select COMMON_CLK if !MTK_CLKMGR
	select GENERIC_CLOCKEVENTS
	select ARM_AMBA
	select CPU_V7
	select HAVE_SMP
	select IRQ_DOMAIN
	select IRQ_DOMAIN_DEBUG
	select ARCH_REQUIRE_GPIOLIB
	select KERNEL_MODE_NEON
	select CRYPTO_AES_ARM_BS
	select ARM_HAS_SG_CHAIN
	select MTK_BASE_POWER
	select MFD_SYSCON
	select CPU_IDLE
	select CPU_IDLE_GOV_MTK
	select ARM_ERRATA_814220
	select MTK_SYS_CIRQ
	select MTK_GIC_EXT
	select MTK_SYSTRACKER
	select ARM_GIC_V3
	select HIGHMEM
	select NEON
	select AEABI
	select VFP
	select SMP
	select USE_OF
	select HAVE_ARM_ARCH_TIMER
	select POWER_SUPPLY
	select POWER_RESET
	select AUTO_ZRELADDR
	select ARM_PSCI
	select ARM_CRYPTO
	help
	  This enable support for MediaTek MT8163. If you need support
	  for MediaTek MT8163, say Y here.
	  Please note this also select ARCH_MEDIATEK, so driver depends
	  on it can be selected.
```

## drivers/input/touchscreen/mediatek/Kconfig
```kconfig
#
# Touchscreen driver configuration
#
menuconfig INPUT_TOUCHSCREEN
	bool "Touchscreens"
	help
	  Say Y here, and a list of supported touchscreens will be displayed.
	  This option doesn't affect the kernel.

	  If unsure, say Y.

if INPUT_TOUCHSCREEN

config TOUCHSCREEN_MTK
	bool "MediaTek Touch Panel Driver"
	help
	Say Y here if you have MediaTek touch panel.

	If unsure, say N.

	To compile this dirver as a module, choose M here: the
	module will be called.

config TOUCHSCREEN_MTK_FT5X0X
	bool "FT5X0X for Mediatek package"
	default n
	help
	  Say Y here if you have FT5X0X touch panel.

	  If unsure, say N.

	  To compile this dirver as a module, choose M here: the
	  module will be called.

source "drivers/input/touchscreen/mediatek/ft5x0x/Kconfig"

config TOUCHSCREEN_MTK_GT5668
	bool "GT5668 for Mediatek package"
	default n
	help
	Say Y here if you have GT5668 touch panel.

	If unsure, say N.

config TOUCHSCREEN_SET_INTERRUPT_TO_INPUT
	bool "Set Interrupt pin to input manually"
	depends on abe123
	default n
	help
	Set to ensure interrupt pin on touch panel is set
	to input mode using gpio subsystem.

source "drivers/input/touchscreen/mediatek/GT5668/Kconfig"

endif
```

## drivers/input/touchscreen/mediatek/focaltech_touch/Kconfig
```kconfig
#
# Touchscreen driver configuration
#
config TOUCHSCREEN_MTK_FOCALTECH_TS
    bool "Focaltech Ts for Mediatek"
    depends on I2C
    default n
    help
      Say Y here if you have Focaltech touch panel.
      If unsure, say N.

config TOUCHSCREEN_MTK_FTS_DIRECTORY
    string "Focaltech ts directory name"
    default "focaltech_touch"
    depends on TOUCHSCREEN_MTK_FOCALTECH_TS

config TOUCHSCREEN_MTK_VDD_SUSPEND
	bool "Focaltech suspend by VDD"
	default n
	depends on TOUCHSCREEN_MTK_FOCALTECH_TS
	help
		Say Y here if driver suspend by VDD low.
		If unsure, say N.
```

## drivers/misc/mediatek/accdet/Kconfig
```kconfig
config MTK_ACCDET
	bool "MediaTek ACCDET driver"
	---help---
	  ACCDET driver is for headset detect and support for MediaTek SOC
	  If you want to use MediaTek ACCDET driver,
	  say Y.
	  If unsure, say N.

config MTK_ACCDET_PMIC_CHIP_MT6323
	bool "Mediatek ACCDET PMIC MT6323 driver"
	depends on MTK_ACCDET
	---help---

	  ACCDET driver support for PMIC MT6323

	  If you want to use mt6323 ACCDET driver,
	  say Y or M here.

	  If unsure, say N.

config MTK_AMZN_ACCDET
	tristate "abc123/abh123/rbc123/abc123 ACCDET driver"
	---help---

	ACCDET driver support for abh123, abc123, rbc123 and abc123 with MTK SOC

	If you want to use abh123, abc123, rbc123 and abc123 ACCDET driver,
	say Y or M here.

	If unsure, say N.

config ACCDET_EINT
	bool "MediaTek ACCDET AP EINT"
	---help---
	  ACCDET External EINT(AP GPIO) support for MediaTek SOC
	  If you want to use MediaTek ACCDET EINT from AP GPIO,
	  say Y.
	  If unsure, say N.

config ACCDET_EINT_IRQ
	bool "MediaTek ACCDET PMIC EINT"
	---help---
	  ACCDET Internal EINT(PMIC) support for MediaTek SOC
	  If you want to use MediaTek ACCDET EINT from PMIC,
	  say Y.
	  If unsure, say N.

config ACCDET_SUPPORT_EINT0
	bool "MediaTek ACCDET PMIC EINT0"
	---help---
	  ACCDET use Internal EINT0(PMIC) support for MediaTek SOC
	  If you just want to use MediaTek PMIC ACCDET EINT0,
	  say Y.
	  If unsure, say N.

config ACCDET_SUPPORT_EINT1
	bool "MediaTek ACCDET PMIC EINT1"
	---help---
	  ACCDET use Internal EINT1(PMIC) support for MediaTek SOC
	  If you just want to use MediaTek PMIC ACCDET EINT1,
	  say Y.
	  If unsure, say N.

config ACCDET_SUPPORT_BI_EINT
	bool "MediaTek ACCDET PMIC EINT0 and EINT1"
	---help---
	  ACCDET use Internal EINT0&EINT1(PMIC) support for MediaTek SOC
	  If you want to use MediaTek PMIC ACCDET EINT0&EINT1,
	  say Y.
	  If unsure, say N.

config HEADSET_TRI_KEY_CDD
	bool "MediaTek three key headset support CDD"
	---help---
	  HEADSET_TRI_KEY_CDD support for MediaTek SOC
	  If you want to support MediaTek CDD three key headset,
	  say Y here.
	  If unsure, say N.

config HEADSET_SUPPORT_FIVE_POLE
	bool "MediaTek five pole Headset"
	---help---
	  ACCDET support 5-pole headset support for MediaTek SOC
	  If you want to support 5-pole headset,
	  say Y.
	  If unsure, say N.

config ACCDET_PIN_SWAP
	bool "MediaTek ACCDET PIN_SWAP"
	---help---
	  ACCDET_PIN_SWAP support for MediaTek SOC
	  If you want to use MediaTek ACCDET PIN SWAP,
	  say Y.
	  If unsure, say N.

config ACCDET_PIN_RECOGNIZATION
	bool "MediaTek ACCDET PIN_RECONIZATION"
	---help---
	  ACCDET_PIN_RECOGNIZATION support for MediaTek SOC
	  If you want to use MediaTek ACCDET PIN RECOGNIZATION,
	  say Y.
	  If unsure, say N.

config FOUR_KEY_HEADSET
	bool "MediaTek four key headset"
	---help---
	  FOUR_KEY_HEADSET support for MediaTek SOC
	  If you want to use MediaTek ACCDET four key headset,
	  say Y.
	  If unsure, say N.

config MOISTURE_INT_SUPPORT
	bool "MediaTek moisture detect support to ues internal resitance"
	---help---
	  MOISTURE_SUPPORT support for MediaTek SOC
	  If you want to use MediaTek moisture detect support,
	  but the micbias will use the internal resitance.
	  say Y here.
	  If unsure, say N.

config MOISTURE_EXT_SUPPORT
	bool "MediaTek moisture detect support to ues external resitance"
	---help---
	  MOISTURE_SUPPORT support for MediaTek SOC
	  If you want to use MediaTek moisture detect support,
	  but the micbias will use the external resitance.
	  say Y here.
	  If unsure, say N.

config MT6771_QUERY_PCB_ID
	bool "Mediatek mt6771, query pcbID to check ACC mode or DCC mode"
	---help---
	  Query PCBID to get PCB version and check which mic-mode is supported.
	  mt6771: we get pcb info from GPIO111&GPIO175
	  0  0:EVB, 0 1:phone_DCC,   1 0: phone_ACC,   1 1:Reserved.
	  say yes for mtk internal device, othwise say no.
	  If unsure, say N.

config TS3A225E_ACCDET
	bool "MediaTek ACCDET ts3a225e"
	---help---
	  TS3A225E support for MediaTek SOC
	  If you want to use TS3A225E
	  say Y.
	  If unsure, say N.

config ACCDET_OMTP_CTIA_SWITCH
	bool "MediaTek ACCDET driver"
	---help---

	  Switch IC - FSA8049 - support for MediaTek SOC

	  If you want to use MediaTek ACCDET PIN SWAP,
	  say Y or M here.

	  If unsure, say N.

config ACCDET_OMTP_CTIA_SWITCH_MANUAL
	bool "MediaTek ACCDET driver"
	---help---

	  Switch IC - SD80 or FSA3157 - support for MediaTek SOC

	  If you want to use MediaTek ACCDET PIN SWAP,
	  say Y or M here.

	  If unsure, say N.

config ACCDET_USE_VCAMAF_POWER
         bool "MediaTek ACCDET driver"
         ---help---

           Use VCAMAF POWER FOR MICBIAS

           If you want to use MediaTek ACCDET VCAMAF POWER,
           say Y or M here.

           If unsure, say N.
```

## drivers/misc/mediatek/accelerometer/bma253/Kconfig
```kconfig
config MTK_BMA253
	bool "BMA253 for MediaTek package"
	default n
	help
	  It support different accelerometer sensor.
          If this option is set,
	  it will support
          BMA253 Accelerometer.
```

## drivers/misc/mediatek/accelerometer/lsm6ds3g/Kconfig
```kconfig
config MTK_LSM6DS3G
	bool "LSM6DS3 accelerometer for MediaTek package"
	default n
```

## drivers/misc/mediatek/alsps/jsa1214/Kconfig
```kconfig
config MTK_JSA1214
	bool "JSA1214 for MediaTek package"
	default n
	help
	  If this option is set, it will support
	  ambient and light sensor JSA1214.

config MTK_JSA1214_SWITCH_RANGE_AUTO
	bool "JSA1214 support for switching range automatic"
	default n
	depends on MTK_JSA1214
	help
	  If this option is set, it will support
	  for switching range automatic.

config ALS_FORMULA_CHANGE
	bool "JSA1214 support read productid2.If 1, use old formula,else, use new formula"
	default n
	depends on MTK_JSA1214
	help
	  If this option is set, it will support
	  for changing als formula.

config ALS_WHITE_RANGE_CHANGE
	bool "JSA1214 support for switching white range"
	default n
	depends on MTK_JSA1214
	help
	  If this option is set, it will support
	  for searching abc123 evt white device.
```
